&mt6375_typec {
	pd-data {	
		pd,vid = <0x29cf>;
		pd,pid = <0x6375>;
		pd,source-cap-ext = /bits/ 8 <0xcf 0x29 0x75 0x63
					      0x00 0x00 0x00 0x00
					      0x00 0x00 0x00 0x00
					      0x00 0x00 0x00 0x00
					      0x00 0x00 0x00 0x00
					      0x00 0x00 0x01 0x02
					      0x00>;
		pd,sink-cap-ext = /bits/ 8 <0xcf 0x29 0x75 0x63
					    0x00 0x00 0x00 0x00
					    0x00 0x00 0x01 0x00
					    0x00 0x00 0x00 0x00
					    0x01 0x0b 0x01 0x0a
					    0x28 0x00 0x00 0x00>;
		pd,mfrs = "RichtekTCPC";

		/*
		 *	VSAFE5V = 0, MAX_POWER = 1, CUSTOM = 2,
		 *	MAX_POWER_LV = 0x21, MAX_POWER_LVIC = 0x31
		 *	MAX_POWER_HV = 0x41, MAX_POWER_HVIC = 0x51
		 */
		pd,charging-policy = <2>;

		pd,source-pdo-size = <2>;
		pd,source-pdo-data = <0x00019032 0x000190c8>; /* 5V, 2000 mA */
		pd,sink-pdo-size = <3>;
		pd,sink-pdo-data = <0x000190c8 0x0002d0c8 0xc0c83250>;

		/*
		 * No DP Sink capability
		 *	pd,id-vdo-size = <6>;
		 *	pd,id-vdo-data = <0xd14029cf 0x0 0x63750000
					  0x61000000 0x0 0x41000000>;
		 * With DP Sink capability
		 *	pd,id-vdo-size = <6>;
		 *	pd,id-vdo-data = <0xd54029cf 0x0 0x63750000
					  0x61000000 0x0 0x41000000>;
		 */

		pd,id-vdo-size = <6>;
		pd,id-vdo-data = <0xd14029cf 0x0 0x63750000
				  0x61000000 0x0 0x41000000>;

		bat,nr = <1>;
		bat-info0 {
			bat,vid = <0x29cf>;
			bat,pid = <0x6375>;
			bat,mfrs = "bat1";
			bat,design-cap = <3000>;
		};
	};
};
