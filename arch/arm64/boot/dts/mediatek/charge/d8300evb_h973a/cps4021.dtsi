#include <dt-bindings/phy/phy.h>

&i2c5 {
	clock-frequency = <400000>;
	cps4021@30 {
		compatible = "wireless_charger,cps4021";
		reg = <0x30>;
		status = "okay";
		powergood-gpios = <&pio 21 0x0>;
		eint_wpc-gpios = <&pio 8 0x0>;
		wired-gpios = <&pio 19 0x0>;
		//sleep-gpios = <&pio 22 0x0>;
		dv_vctrl-gpios = <&pio 20 0x0>;
		//tx_mode-gpios = <&pio 95 0x0>;
		//ovp_ctrl-gpios = <&pio 54 0x0>;
	};
};