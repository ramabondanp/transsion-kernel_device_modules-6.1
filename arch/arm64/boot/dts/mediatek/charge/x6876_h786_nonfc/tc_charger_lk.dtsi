&lk_charger {
	compatible = "mediatek,lk_charger";
	enable_anime;
	enable_pe_plus;
	enable_pd20_reset;
	power_path_support;
	max_charger_voltage = <6500000>;
	fast_charge_voltage = <2300000>;
	low_bat_temp_boot_vbat = <3600000>;

	/* charging current */
	usb_charger_current = <500000>;
	ac_charger_current = <2000000>;
	ac_charger_input_current = <2000000>;
	non_std_ac_charger_current = <1200000>;
	charging_host_charger_current = <1500000>;
	ta_ac_charger_current = <3000000>;
	pd_charger_current = <500000>;

	cur_threshold = <500000>;
	temp_t0_current = <1500000>;
	temp_neg_t0_current = <500000>;
	/* battery temperature protection */
	temp_t4_threshold = <56>;
	temp_t3_threshold = <45>;
	temp_t2_threshold = <15>;
	temp_t1_threshold = <10>;
	temp_t0_threshold = <0>;
	temp_neg_t0_threshold = <(-20)>;
};
