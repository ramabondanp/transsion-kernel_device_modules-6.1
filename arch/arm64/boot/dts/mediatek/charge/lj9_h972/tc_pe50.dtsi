/*
 * Copyright (c) 2019 Richtek
 *
 * This program is free software; you can redistribute it and/or modify
 * it under the terms of the GNU General Public License version 2 as
 * published by the Free Software Foundation.
 *
 * This program is distributed in the hope that it will be useful,
 * but WITHOUT ANY WARRANTY; without even the implied warranty of
 * MERCHANTABILITY or FITNESS FOR A PARTICULAR PURPOSE.  See the
 * GNU General Public License for more details.
 */

&pe5{
	compatible = "tc_pe5";
	status = "okay";
	tc_chgtype = <&tc_chgtype>;
	polling_interval = <500>;
	ta_cv_ss_repeat_tmin = <25>;
	vbat_cv = <4530>;
	start_vbat_min = <3200>;
	start_vbat_max = <4450>;
	idvchg_term = <400>; // ibus 2 : 1
	idvchg_pps_term = <500>;
	rcable_level = <300 350 450 600>;
	ita_level = <7000 5000 4600 3250>;
	idvchg_level_multi = <3300 7000 7000 7000>;
	idvchg_ss_init = <1000>;
	idvchg_ss_step = <250>;
	idvchg_ss_step1 = <100>;
	idvchg_ss_step2 = <50>;
	idvchg_ss_step1_vbat = <4000>;
	idvchg_ss_step2_vbat = <4200>;
	ta_blanking = <400>;
	chg_time_max = <36000>;
	wireless_chg_time_max = <72000>;

	tta_level_def	= <0     0     0     5     25    25    25    25    25    25    25    25    25    25    80    85    2000>;
	tta_curlmt 	= <(-1)  (-1)  (-1)  0     0     0     0     0     0     0     0     0     0     0     600   900   (-1)>;
	tta_recovery_area	= <1>;

	tdvchg_level_def	 = <0     0     0     5     25    25    25    25    25    25    25    25    25    25    75    80    170>;
	tdvchg_curlmt	 = <(-1)  (-1)  (-1)  0     0     0     0     0     0     0     0     0     0     0     600   900   (-1)>;
	tdvchg_recovery_area	= <1>;

	tbat_level_def	 = <10    10    10    15    25    25    25    25    25    25    25    25    41    42    43    45    46>;
	tbat_curlmt	 = <(-1)  (-1)  0     0     0     0     0     0     0     0     0     0     1400  2000  2200  2200  (-1)>;

	tpcb_level_def	= <0     0     0     22    25    25    25    25    41    42    43    44    45    46    47    48    90>;
	tpcb_curlmt	= <(-1)  (-1)  0     0     0     0     0     0     1000  2200  1400  1400  1400  1400  2200  2200  (-1)>;

	tpa_level_def	= <0     0     0     22    25    25    25    25    41    42    43    44    45    46    47    48    90>;
	tpa_curlmt	= <(-1)  (-1)  0     0     0     0     0     0     1000  2200  3000  3400  3800  1400  2200  2200  (-1)>;

	supprot_multi_level_charging;
	//tbat
	tbat_level_def_0	= <10    10    10    15    25    38    38    39    40    41    42    43    44    45    45    45    46>;
	tbat_curlmt_0	= <(-1)  (-1)  0     0     0     600  600  1200  1700  2200  2800  3500  4000  4500  4500  4500  (-1)>;
	tbat_level_def_1	= <10    10    10    22    25    36    36    37    38    39    40    42    43    44    45    45    46>;
	tbat_curlmt_1	= <(-1)  (-1)  0     0     0     1000  1000  1600  2200  2800  3400  3900  4300  4600  5300  5300  (-1)>;
	tbat_level_def_2	= <10    10    10    22    25    30    31    32    33    34    36    38    40    41    43    45    46>;
	tbat_curlmt_2	= <(-1)  (-1)  0     0     0     1000  200  2500  3500  4500  4800  5000  5000  5000  5000  5000  (-1)>;
    tbat_recovery_area	= <1>;

	//tpcb
	tpcb_level_def_0	= <0     0     0     22    25    39    39    39    40    41    42    43    44    45    45    46    90>;
	tpcb_curlmt_0	= <(-1)  (-1)  0     0     0     800  800  800  1400  1900  2400  3000  3500  4500  4500  5000  (-1)>;
	tpcb_level_def_1	= <0     0     0     22    25    36    36    37    38    39    40    42    43    44    45    45    90>;
	tpcb_curlmt_1	= <(-1)  (-1)  0     0     0     1000  1000  1600  2200  2800  3400  3900  4300  4600  5300  5300  (-1)>;
	tpcb_level_def_2	= <0     0     0     22    25    28    29    30    32    34    35    37    39    40    42    45    90>;
	tpcb_curlmt_2	= <(-1)  (-1)  0     0     0     1000  2000  2500  3500  4500  4800  5000  5000  5000  5000  5000  (-1)>;
    tpcb_recovery_area	= <1>;

	//tpa
	tpa_level_def_0   = <0     0     0     22    25    25    25    25    25    25    43    44    45    46    47    48    90>;
	tpa_curlmt_0      = <(-1)  (-1)  0     0     0     0     0     0     0     0     1500  2000  2500  3000  3500  4250  (-1)>;
	tpa_level_def_1   = <0     0     0     22    25    25    25    25    25    25    43    44    45    46    47    48    90>;
	tpa_curlmt_1      = <(-1)  (-1)  0     0     0     0     0     0     0     0     1500  2000  2500  3000  3500  4250  (-1)>;
	tpa_level_def_2   = <0     0     0     22    25    25    25    25    25    25    42    43    44    45    46    47    90>;
	tpa_curlmt_2      = <(-1)  (-1)  0     0     0     0     0     0     0     0     1500  2000  2500  3000  3500  4250  (-1)>;
	tpa_recovery_area           = <1>;

	//wireless
    support_wireless_pdp_limit;
	wireless_tbat_level_def     = <10    10    10    15    25    25    25    25    25    25    25    35    36    37    38    39    46>;
	wireless_tbat_curlmt        = <(-1)  (-1)  0     0     0     0    0     0     0     0      0     300   400  500  600  800  (-1)>;

	wireless_tpcb_level_def     = <0     0     0     22    25    25    25    25    25    25    25    37    38    39    40    41    90>;
	wireless_tpcb_curlmt        = <(-1)  (-1)  0     0     0     0     0     0     0    0      0     300   400   500   600  800 (-1)>;

	wireless_tpa_level_def      = <0     0     0     22    25    38    38    38    38    38    38    38    38    38    40    43    90>;
	wireless_tpa_curlmt         = <(-1)  (-1)  0     0     0     0     0     0     0     0     0     0     0     0     400   500  (-1)>;

    wireless_tbat_level_def_h     = <10    10    10    15    25    25    25    25    25    25    25    35    36    37    38    39    46>;
	wireless_tbat_curlmt_h        = <(-1)  (-1)  0     0     0     0     0     0     0     0     0     0   500   800  900  1200  (-1)>;

	wireless_tpcb_level_def_h     = <0     0     0     22    25    25    25    25    25    25    25    37    38    39    40    41    90>;
	wireless_tpcb_curlmt_h        = <(-1)  (-1)  0     0     0     0     0     0     0     0     0     0   500   800   900  1200 (-1)>;

	wireless_tpa_level_def_h      = <0     0     0     22    25    38    38    38    38    38    38    38    38    38    40    43    90>;
	wireless_tpa_curlmt_h         = <(-1)  (-1)  0     0     0     0     0     0     0     0     0     0     0     0     1000   1200  (-1)>;

	sys_power_level_def         = <0     0     400   500   600  800  1200  1400  1600  2000  2400  2800  3200  3600  4000  4400  50000>;
	sys_power_curlmt            = <(-1)  (-1)  0     0     0     3200  2800  2400  2000  1600  1200  1200  1200  1200  1200  1200  (-1)>;
	sys_power_recovery_area     = <400>;

	ifod_threshold = <200>;
	rsw_min = <20>;
	ircmp_rbat = <10>;
	ircmp_vclamp = <15>; /* mV */
	support_ta = "pd_adapter";
	allow_not_check_ta_status;
        vbat_threshold = <4350>;
	rechg_tbat_high = <44>;
	rechg_tbat_low = <12>;
	project_pwr_ratio = <70>;
	project_power = <70>;
	min_ita_gap = <10>;
	ita_stable_cnt = <20>;
	vol_diff_gap = <50>;
	cable_capability_level = <0 5000 6000 7000>;
	vol_diff_level = <1000 1000 1200 1500>;

	/*wireless charger*/
	wireless_curlmt = <2200 2200 2200 2200 2200>;
	/*Wireless EOC*/
	idvchg_wireless_term = <300>;
        /*0:2:1 or 4:2 cp
          1:4:2:1 cp*/
    wireless_en_dual= <0>;
	pe50_wireless_vta_init = <9000>;
	pe50_wireless_ita_init = <3000>;
	 pe50_wireless_pdp_limit = <30>;
	pe50_vta_init = <5300>;
	pe50_ita_init = <3000>;
        pe50_default_vta_step = <20>;

	run_cp_cur = <0 2500 4250 9000>;
	run_cp_recovery_gap = <0 500 750 1000>;
	run_wls_cp_cur = <0 3000 6000 10000>;
	run_wls_cp_recovery_gap = <0 200 400 600>;

	/* support_6_2; */
	/* support_4_1; */
	/* support_4_2; */
	/* support_2_1; */
	/* support_1_1; */
	support_spec =  <0 0 0 1 0>;
	vta_cap_min = <6800 6800 6800 6000 4000>;
	vta_cap_max = <30500 20500 20500 10500 7000>;
	ita_cap_min = <1000 1000 1000 1000 1000>;
	vbus_max_ovp = <33000 20500 20500 11000 7000>;

	/* battery step cv param */
	pe5_ffc_gap = <20 20 20 20 20 20>;

	step_ffc_level = <7>;
	step_ffc_level_0 = <10 15				/* ffc temp */
		4200  4300  4300  4400  4500  4500	/* ffc vbat */
		7020  7020  7020  7020  7020  7020	/* ffc ibat */
		300									/* ffc term */
		(-1) (-1)							/* cycle cnt(write (-1) if not supported long life) */
		0 (-1)>;								/* cv gap& rechg cur, write (-1) if not support */

	/*15~35��C,0 ~ 300 cycle*/
	step_ffc_level_1 = <15 35
		4250  4350  4500  4530  4530 4530
		14000 11700 8775  5850  5850 5850
		920
		0 300
		0 (-1)>;

	/*15~35��C,300 ~ 600 cycle*/
	step_ffc_level_2 = <15 35
		4250  4350  4500  4510  4510 4510
		14000 11700 8775  5850  5850 5850
		920
		300 600
		20 (-1)>;

	/*15~35��C,more than 600 cycle*/
	step_ffc_level_3 = <15 35
		4250  4350  4490  4490  4490 4490
		14000 11700 8775  5850  5850 5850
		920
		600 (-1)
		40 (-1)>;

	/*35~45��C,0 ~ 300 cycle*/
	step_ffc_level_4 = <35 45
		4250  4350  4500  4530  4530 4530
		14000 11700 8775  5850  5850 5850
		980
		0 300
		0 (-1)>;

	/*35~45��C,300 ~ 600 cycle*/
	step_ffc_level_5 = <35 45
		4250  4350  4500  4510  4510 4510
		14000 11700 8775  5850  5850 5850
		980
		300 600
		20 (-1)>;

	/*35~45��C,more than 1000 cycle*/
	step_ffc_level_6 = <35 45
		4250  4350  4490  4490  4490 4490
		14000 11700 8775  5850  5850 5850
		980
		600 (-1)
		40 (-1)>;
};
