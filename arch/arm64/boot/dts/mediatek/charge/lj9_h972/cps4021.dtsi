#include <dt-bindings/phy/phy.h>
&i2c1 {
	status = "okay";
	clock-frequency = <400000>;
	#address-cells = <1>;
	#size-cells = <0>;

	cps4021@30 {
		compatible = "wireless_charger,cps4021";
		reg = <0x30>;
		status = "okay";
		powergood-gpios = <&pio 61 0x0>;
		eint_wpc-gpios = <&pio 29 0x0>;
		wired-gpios = <&pio 42 0x0>;
		sleep-gpios = <&pio 136 0x0>;
		dv_vctrl-gpios = <&pio 132 0x0>;
	};
};
