/*
 * Copyright (c) 2019 Richtek
 *
 * This program is free software; you can redistribute it and/or modify
 * it under the terms of the GNU General Public License version 2 as
 * published by the Free Software Foundation.
 *
 * This program is distributed in the hope that it will be useful,
 * but WITHOUT ANY WARRANTY; without even the implied warranty of
 * MERCHANTABILITY or FITNESS FOR A PARTICULAR PURPOSE.  See the
 * GNU General Public License for more details.
 */

&pe5{
	compatible = "tc_pe5";
	status = "okay";
	tc_chgtype = <&tc_chgtype>;
        polling_interval = <500>;
        ta_cv_ss_repeat_tmin = <25>;
        vbat_cv = <4530>;
        start_vbat_min = <3300>;
        start_vbat_max = <4400>;
        idvchg_term = <400>; // ibus 2 : 1
        idvchg_pps_term = <1200>;
	rcable_level = <300 350 450 600>;
        ita_level = <4000 3800 3500 3000>;
        idvchg_level_multi = <4000 7000 7000 7000>;
        idvchg_ss_init = <1000>;
        idvchg_ss_step = <250>;
        idvchg_ss_step1 = <100>;
        idvchg_ss_step2 = <50>;
        idvchg_ss_step1_vbat = <4000>;
        idvchg_ss_step2_vbat = <4200>;
        ta_blanking = <400>;
        chg_time_max = <36000>;

	tta_level_def              = <0     0     0     5     25    25    25    25    25    25    25    25    25    25    80    85    2000>;
	tta_curlmt                 = <(-1)  (-1)  (-1)  0     0     0     0     0     0     0     0     0     0     0     600   900   (-1)>;
	tta_recovery_area          = <1>;

	tdvchg_level_def           = <0     0     0     5     25    25    25    25    25    25    25    25    25    25    75    80    170>;
	tdvchg_curlmt              = <(-1)  (-1)  (-1)  0     0     0     0     0     0     0     0     0     0     0     600   900   (-1)>;
	tdvchg_recovery_area       = <1>;

	tbat_level_def             = <9    9    9    25    30    32    34    35    36    37    38    40    41    43    44    45    46>;
	tbat_curlmt                = <(-1)  (-1)  0   0    0     0     900   1100  1300  1500  1700  1900  2100  2300  2500  2600  (-1)>;
	tbat_recovery_area         = <1>;

	tpcb_level_def             = <0     0     0     25    28    30    34    35    36    37    38    39    40    41    43    44    90>;
	tpcb_curlmt                = <(-1)  (-1)  0     0     0     0     900   1100  1300  1500  1700  1900  2100  2300  2500  2800  (-1)>;
	tpcb_recovery_area         = <1>;

	tpa_level_def              = <0     0     0     22    25    25    34    35    36    37    38    39    40    41    42    44    90>;
	tpa_curlmt                 = <(-1)  (-1)  0     0     0     0     900   1100  1300  1500  1700  1900  2100  2300  2500  2800  (-1)>;
	tpa_recovery_area          = <1>;

	supprot_multi_level_charging;
	//tbat
	tbat_level_def_0           = <9    9    9    25    30    32    34    37    38    39    40    41    42    43    44    45    46>;
	tbat_curlmt_0              = <(-1)  (-1)  0    0    0     0    0     800   1000  1200  1400  1600  1800  2000  2200  2400  (-1)>;
	tbat_level_def_1           = <9    9    9    25    30    32    34    35    36    37    38    40    41    43    44    45    46>;
	tbat_curlmt_1              = <(-1)  (-1)  0   0    0     0     900   1100  1300  1500  1700  1900  2100  2300  2500  2600  (-1)>;
	tbat_level_def_2           = <9    9    9    25    28    30    32    34    35    36    37    38    40    42    44    45    46>;
	tbat_curlmt_2              = <(-1) (-1) 0    0     1500  1700  1900  2100  2200  2300  2400  2500  2600  2700  2700  2700 (-1)>;

	//tpcb
	tpcb_level_def_0           = <0     0     0     25    28    30    32    35    37    38    39    41    42    43    44    45    90>;
	tpcb_curlmt_0              = <(-1)  (-1)  0     0     0     0     0     0     500   800   1100  1400  1700  2000  2300  2800  (-1)>;
	tpcb_level_def_1           = <0     0     0     25    28    30    34    35    36    37    38    39    40    41    43    44    90>;
	tpcb_curlmt_1              = <(-1)  (-1)  0     0     0     0     900   1100  1300  1500  1700  1900  2100  2300  2500  2800  (-1)>;
	tpcb_level_def_2           = <0     0     0     22    25    29    30    32    33    35    37    39    41    43    44    45    90>;
	tpcb_curlmt_2              = <(-1)  (-1)  0     0     0     1600  1700  1900  2100  2200  2300  2400  2500  2800  2800  2800  (-1)>;

	//tpa
	tpa_level_def_0            = <0     0     0     22    25    25    25    25    38    39    41    42    43    44    45    46    90>;
	tpa_curlmt_0               = <(-1)  (-1)  0     0     0     0     0     0     500   800   1100  1400  1600  2000  2300  2800  (-1)>;
	tpa_level_def_1            = <0     0     0     22    25    25    34    35    36    37    38    39    40    41    42    44    90>;
	tpa_curlmt_1               = <(-1)  (-1)  0     0     0     0     900   1100  1300  1500  1700  1900  2100  2300  2500  2800  (-1)>;
	tpa_level_def_2            = <0     0     0     22    25    25    25    29    30    32    33    35    37    39    41    43    90>;
	tpa_curlmt_2               = <(-1)  (-1)  0     0     0     0     0     1600  1700  1900  2100  2200  2300  2400  2500  2800  (-1)>;

	sys_power_level_def        = <0     0     400   400   400  800  1200  1400  1600  2000  2400  2800  3200  3600  4400  4800  9000>;
	sys_power_curlmt           = <(-1)  (-1)  0     0     0    3200 2800  2400  2000  1600  1200  1200  1200  1200  1200  1200  (-1)>;
	sys_power_recovery_area    = <400>;

        ifod_threshold = <200>;
        rsw_min = <20>;
        ircmp_rbat = <4>;
        ircmp_vclamp = <6>;
        support_ta = "pd_adapter";
        allow_not_check_ta_status;
        vbat_threshold = <4350>;
	rechg_tbat_high = <44>;
	rechg_tbat_low = <10>;
	project_pwr_ratio = <70>;
	project_power = <45>;
	min_ita_gap = <10>;
	ita_stable_cnt = <20>;
	vol_diff_gap = <50>;
	cable_capability_level = <0 5000 6000 7000>;
	vol_diff_level = <1000 1000 1200 1500>;

	pe50_vta_init = <5300>;
	pe50_ita_init = <3000>;

        run_cp_cur = <0 2500 4250 9000>;
        run_cp_recovery_gap = <0 500 750 1000>;
        run_wls_cp_cur = <0 3000 6000 10000>;
        run_wls_cp_recovery_gap = <0 200 400 600>;

        /* support_6_2; */
        /* support_4_1; */
        /* support_4_2; */
        /* support_2_1; */
	/* support_1_1; */
	support_spec =  <0 0 0 1 0>;
	vta_cap_min = <6800 6800 6800 6800 4000>;
	vta_cap_max = <30500 20500 20500 10500 7000>;
	ita_cap_min = <1000 1000 1000 1000 1000>;
	vbus_max_ovp = <33000 20500 20500 11000 7000>;

        /* battery step cv param */
        pe5_ffc_gap = <20 20 20 20 20 20>;

        step_ffc_level = <12>;

        step_ffc_level_0 = <10 15
                            4470  4470  4470  4470  4470  4470
                            5350  5350  5350  5350  5350  5350
                            270
			    (0) (100)
			    0>;

        step_ffc_level_1 = <10 15
                            4480  4480  4480  4480  4480  4480
                            5350  5350  5350  5350  5350  5350
                            270
			    (100) (200)
			    0>;

        step_ffc_level_2 = <10 15
                            4490  4490  4490  4490  4490  4490
                            5350  5350  5350  5350  5350  5350
                            270
			    (200) (300)
			    0>;

        step_ffc_level_3 = <10 15
                            4500  4500  4500  4500  4500  4500
                            5350  5350  5350  5350  5350  5350
                            270
			    (300) (-1)
			    0>;

        step_ffc_level_4 = <15 35                            /* ffc temp */
                            4200  4470  4500  4500  4500  4500     /* ffc vbat */
                            8000  6955  5350  5350  5350  5350      /* ffc ibat */
                            1070		             /* ffc term */
			    (0) (100)                          /* cycle cnt(write 0 if not supported long life) */
			    0>;                             /* rechg gap */

        step_ffc_level_5 = <15 35
                            4200  4480  4510  4510  4510  4510
                            8200  6955  5350  5350  5350  5350
                            1070
			    (100) (200)
			    0>;

        step_ffc_level_6 = <15 35
                            4200  4490  4520  4520  4520  4520
                            8200  6955  5350  5350  5350  5350
                            1070
			    (200) (300)
			    0>;

        step_ffc_level_7 = <15 35
                            4200  4500  4530  4530  4530  4530
                            8200  6955  5350  5350  5350  5350
                            1070
			    (300) (-1)
			    0>;

        step_ffc_level_8 = <35 45
                            4200  4470  4500  4500  4500  4500
                            8200  6955  5350  5350  5350  5350
                            1070
			    (0) (100)
			    0>;

        step_ffc_level_9 = <35 45
                            4200  4480  4510  4510  4510  4510
                            8200  6955  5350  5350  5350  5350
                            1605
			    (100) (200)
			    0>;

        step_ffc_level_10 = <35 45
                            4200  4490  4520  4520  4520  4520
                            8200  6955  5350  5350  5350  5350
                            2140
			    (200) (300)
			    0>;

        step_ffc_level_11 = <35 45
                            4200  4500  4530  4530  4530  4530
                            8200  6955  5350  5350  5350  5350
                            2622
			    (300) (-1)
			    0>;

	/*support_vbat_cycle_level;*/
	/*support_long_life_recharger;*/

	/* dual battery  */
	/* support_dual_battery; */
	/* step_cc_gap = <100>; */
	/* step_master_ffc_level = <2>; */
        /* step_master_ffc_level_0 = <15 35 */
        /*                     4200  4300  4300  4400  4500 4530 */
        /*                     20000 15750 15750 13500 9000 6750 */
        /*                     1440 */
	/*                     0 0 */
	/*                     0>; */
        /* step_master_ffc_level_1 = <35 45 */
        /*                     4200  4300  4300  4400  4500 4530 */
        /*                     20000 15750 15750 13500 9000 6750 */
        /*                     2115 */
	/*                     0 0 */
	/*                     0>; */

	/* step_slave_ffc_level = <2>; */
        /* step_slave_ffc_level_0 = <15 35 */
        /*                     4200  4300  4300  4400  4500 4530 */
        /*                     20000 15750 15750 13500 9000 6750 */
        /*                     1440 */
	/*                     0 0 */
	/*                     0>; */
        /* step_slave_ffc_level_1 = <35 45                       */
        /*                     4200  4300  4300  4400  4500 4530 */
        /*                     20000 15750 15750 13500 9000 6750 */
        /*                     2115 */
	/*                     0 0 */
	/*                     0>; */
};
