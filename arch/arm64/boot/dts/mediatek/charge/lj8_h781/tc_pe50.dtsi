/*
 * Copyright (c) 2019 Richtek
 *
 * This program is free software; you can redistribute it and/or modify
 * it under the terms of the GNU General Public License version 2 as
 * published by the Free Software Foundation.
 *
 * This program is distributed in the hope that it will be useful,
 * but WITHOUT ANY WARRANTY; without even the implied warranty of
 * MERCHANTABILITY or FITNESS FOR A PARTICULAR PURPOSE.  See the
 * GNU General Public License for more details.
 */

&pe5{
	compatible = "tc_pe5";
	status = "okay";
	tc_chgtype = <&tc_chgtype>;
        polling_interval = <500>;
        ta_cv_ss_repeat_tmin = <25>;
        vbat_cv = <4530>;
        start_vbat_min = <3300>;
        start_vbat_max = <4400>;
        idvchg_term = <400>; // ibus 2 : 1
        idvchg_pps_term = <1200>;
		rcable_level = <300 350 450 600>;
        ita_level = <4000 3800 3500 3000>;
        idvchg_level_multi = <4000 7000 7000 7000>;
        idvchg_ss_init = <1000>;
        idvchg_ss_step = <250>;
        idvchg_ss_step1 = <100>;
        idvchg_ss_step2 = <50>;
        idvchg_ss_step1_vbat = <4000>;
        idvchg_ss_step2_vbat = <4200>;
        ta_blanking = <400>;
        chg_time_max = <36000>;
	wireless_chg_time_max = <72000>;

	tta_level_def              = <0     0     0     5     25    25    25    25    25    25    25    25    25    25    80    85    2000>;
	tta_curlmt                 = <(-1)  (-1)  (-1)  0     0     0     0     0     0     0     0     0     0     0     600   900   (-1)>;
	tta_recovery_area          = <1>;

	tdvchg_level_def           = <0     0     0     5     25    25    25    25    25    25    25    25    25    25    75    80    170>;
	tdvchg_curlmt              = <(-1)  (-1)  (-1)  0     0     0     0     0     0     0     0     0     0     0     600   900   (-1)>;
	tdvchg_recovery_area       = <1>;

	tbat_level_def             = <9    9    9    25    34    36    37    38    39    40    41    42    43    44    45    45    46>;
	tbat_curlmt                = <(-1)  (-1)  0   0    0     0     0     500   600   800   1000  1200  1400  1600  1800  2200  (-1)>;
	tbat_recovery_area         = <1>;

	tpcb_level_def             = <0     0     0     25    35    36    37    38    39    40    41    42    43    44    45    46    90>;
	tpcb_curlmt                = <(-1)  (-1)  0     0     0     200   500   800   900   1100  1300  1500  1800  2000  2400  2400  (-1)>;
	tpcb_recovery_area         = <1>;

	tpa_level_def              = <0     0     0     25    36    37    38    39    40    41    42    43    44    45    46    47    90>;
	tpa_curlmt                 = <(-1)  (-1)  0     0     0     0     0     0     1000  2200  3000  3400  3800  4400  5000  6000  (-1)>;
	tpa_recovery_area          = <1>;

	supprot_multi_level_charging;
	//tbat
	tbat_level_def_0           = <9    9    9    25    34    30    32    34    36    37    38    39    40    41    43    44    46>;
	tbat_curlmt_0              = <(-1)  (-1)  0    0    0     0    0     0     0   0   0  500  600  1000  1400  2000  (-1)>;
	tbat_level_def_1           = <9    9    9    25    34    30    32    34    36    37    38    39    40    41    43    44    46>;
	tbat_curlmt_1              = <(-1)  (-1)  0   0    0     0     0     1200   1400   1600   1700  1900  2000  2100  2200  2300  (-1)>;
	tbat_level_def_2           = <9    9    9    25    29    30    32    34    36    37    38    39    40    41    43    44    46>;
	tbat_curlmt_2              = <(-1) (-1) 0    0     0     1600  1700  1900  2100  2200  2300  2300  2300  2300  2300  2400 (-1)>;

	//tpcb
	tpcb_level_def_0           = <0     0     0     25    35    28    30    32    35    36    37    38    39    40    41    43    90>;
	tpcb_curlmt_0              = <(-1)  (-1)  0     0     0     0     0   0   0   0  0  500  600  1000  1400  2000  (-1)>;
	tpcb_level_def_1           = <0     0     0     25    35    28    30    32    35    36    37    38    39    40    41    43    90>;
	tpcb_curlmt_1              = <(-1)  (-1)  0     0     0     0   0   1200   1400   1600  1700  1900  2000  2100  2200  2300  (-1)>;
	tpcb_level_def_2           = <0     0     0     22    25    28    30    32    35    36    37    38    39    40    41    43    90>;
	tpcb_curlmt_2              = <(-1)  (-1)  0     0     0     1600   1700  1900  2100  2200  2300  2300  2300  2300  2300  2400  (-1)>;

	//tpa
	tpa_level_def_0            = <0     0     0     22    25    25    25    25    38    39    41    42    43    44    45    46    90>;
	tpa_curlmt_0               = <(-1)  (-1)  0     0     0     0     0     0     500  800  1100  1400  1600  2000  2300  2800  (-1)>;
	tpa_level_def_1            = <0     0     0     22    25    25    25    25    38    39    41    42    43    44    45    46    90>;
	tpa_curlmt_1               = <(-1)  (-1)  0     0     0     0     0     0     500  800  1100  1400  1600  2000  2300  2800  (-1)>;
	tpa_level_def_2            = <0     0     0     22    25    25    25    25    38    39    41    42    43    44    45    46    90>;
	tpa_curlmt_2               = <(-1)  (-1)  0     0     0     0     0     0     500  800  1100  1400  1600  2000  2300  2800  (-1)>;

	//wireless
	support_wireless_pdp_limit;
	
	wireless_tbat_level_def     = <10    10    10    15    25    25    25    25    25    25    35    36    37    38    39    40    46>;
	wireless_tbat_curlmt        = <(-1)  (-1)  0     0     0     0     0     0     0     0     0     300   400   500  600  800  (-1)>;

	wireless_tpcb_level_def     = <0     0     0     22    25    25    25    25    25    25    25    37    38    39    40    41    90>;
	wireless_tpcb_curlmt        = <(-1)  (-1)  0     0     0     0     0     0     0     0     0     300     400   500   600  800 (-1)>;

	wireless_tpa_level_def      = <0     0     0     22    25    25    25    25    25    25    25    35    36    37    38    39    90>;
	wireless_tpa_curlmt         = <(-1)  (-1)  0     0     0     0     0     0     0     0     0     500   800   1000  1200  1400  (-1)>;
	
	wireless_tbat_level_def_h     = <10    10    10    15    25    25    25    25    35    36    37    38    39    40    42    44    46>;
	wireless_tbat_curlmt_h        = <(-1)  (-1)  0     0     0     0     0     0     500   800   1000  1200  1400  1600  1800  2000  (-1)>;

	wireless_tpcb_level_def_h     = <0     0     0     22    25    25    25    25    25    25    25    37    38    39    40    41    90>;
	wireless_tpcb_curlmt_h        = <(-1)  (-1)  0     0     0     0     0     0     0     0     0     500   800   1000   1000  1400 (-1)>;

	wireless_tpa_level_def_h      = <0     0     0     22    25    38    38    38    38    38    38    38    38    38    40    43    90>;
	wireless_tpa_curlmt_h         = <(-1)  (-1)  0     0     0     0     0     0     0     0     0     0     0     0     400   500  (-1)>;
	
	sys_power_level_def         = <0     0     0   0   0  800  1200  1800  2000  2400  2800  3200  3600  4000  4400  4800  50000>;
	sys_power_curlmt            = <(-1)  (-1)  0     0     0     0  0  2000  1600  1400  1200  1200  1200  1200  1200  1200  (-1)>;
	sys_power_recovery_area     = <400>;

	ifod_threshold = <200>;
	rsw_min = <20>;
	ircmp_rbat = <40>;
	ircmp_vclamp = <0>;
	support_ta = "pd_adapter";
	allow_not_check_ta_status;
        vbat_threshold = <4350>;
	rechg_tbat_high = <44>;
	rechg_tbat_low = <10>;
	project_pwr_ratio = <70>;
	project_power = <45>;
	min_ita_gap = <10>;
	ita_stable_cnt = <20>;
	vol_diff_gap = <50>;
	cable_capability_level = <0 5000 6000 7000>;
	vol_diff_level = <1000 1000 1200 1500>;

	/*wireless charger*/
	wireless_curlmt = <2200 2200 2200 2200 2200>;
	/*Wireless EOC*/
	idvchg_wireless_term = <300>;
        /*0:2:1 or 4:2 cp
          1:4:2:1 cp*/
    wireless_en_dual= <0>;
	pe50_wireless_vta_init = <9000>;
	pe50_wireless_ita_init = <3000>;
	pe50_wireless_pdp_limit = <30>;
	pe50_vta_init = <5300>;
	pe50_ita_init = <3000>;
        pe50_default_vta_step = <20>;

        run_cp_cur = <0 2500 4250 9000>;
        run_cp_recovery_gap = <0 500 750 1000>;
        run_wls_cp_cur = <0 3000 6000 10000>;
        run_wls_cp_recovery_gap = <0 200 400 600>;

        /* support_6_2; */
        /* support_4_1; */
        /* support_4_2; */
        /* support_2_1; */
	/* support_1_1; */
	support_spec =  <0 0 0 1 0>;
	vta_cap_min = <6800 6800 6800 6000 4000>;
	vta_cap_max = <30500 20500 20500 10500 7000>;
	ita_cap_min = <1000 1000 1000 1000 1000>;
	vbus_max_ovp = <33000 20500 20500 11000 7000>;

        /* battery step cv param */
        pe5_ffc_gap = <20 20 20 20 20 20>;

        step_ffc_level = <8>;

        step_ffc_level_0 = <0 10
                            4530  4530  4530  4530  4530  4530
                            2925  2925  2925  2925  2925  2925
                            290
			    (-1) (-1)
			    0>;

        step_ffc_level_1 = <10 15
                            4530  4530  4530  4530  4530  4530
                            5850  5850  5850  5850  5850  5850
                            290
			    (-1) (-1)
			    0>;

        step_ffc_level_2 = <15 35                            /* ffc temp */
                            4200  4500  4530  4560  4560  4560     /* ffc vbat */
                            8200  7605  5850  4095  4095  4095      /* ffc ibat */
                            1462		             /* ffc term */
			    (0) (300)                          /* cycle cnt(write 0 if not supported long life) */
			    0>;                             /* rechg gap */

        step_ffc_level_3 = <15 35
                            4200  4500  4530  4540  4540  4540
                            8200  7605  5850  4095  4095  4095
                            1462
			    (300) (600)
			    0>;

        step_ffc_level_4 = <15 35
                            4200  4500  4520  4520  4520  4520
                            8200  7605  5850  4095  4095  4095
                            1462
			    (600) (-1)
			    0>;

        step_ffc_level_5 = <35 45
                            4200  4500  4530  4560  4560  4560
                            8200  7605  5850  4095  4095  4095
                            2164
			    (0) (300)
			    0>;

        step_ffc_level_6 = <35 45
                            4200  4500  4530  4540  4540  4540
                            8200  7605  5850  4095  4095  4095
                            2164
			    (300) (600)
			    0>;

        step_ffc_level_7 = <35 45
                            4200  4500  4520  4520  4520  4520
                            8200  7605  5850  4095  4095  4095
                            2164
			    (600) (-1)
			    0>;

	/*support_vbat_cycle_level;*/
	/*support_long_life_recharger;*/
};
