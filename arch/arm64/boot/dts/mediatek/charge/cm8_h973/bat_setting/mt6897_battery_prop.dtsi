// SPDX-License-Identifier: GPL-2.0
/*
 * Copyright (c) 2021 MediaTek Inc.
 *
 */

#include <dt-bindings/iio/adc/mediatek,mt6375_auxadc.h>
#include <dt-bindings/iio/mt635x-auxadc.h>

&mtk_gauge {
	difference-fullocv-ith = <(200)>;
	/* Charging termination current */
	shutdown-1-time = <(1200)>;
	/* If ui_soc shows 1% more than X minites, system will shutdown */
	VBAT2_DET_VOLTAGE1 = <30500>;
	VBAT2_DET_VOLTAGE2 = <28000>;
	VBAT2_DET_VOLTAGE3 = <31000>;
	BAT_VOLTAGE_LOW_BOUND = <3000>;
	LOW_TMP_BAT_VOLTAGE_LOW_BOUND = <3100>;
	SHUTDOWN_GAUGE0_VOLTAGE = <3000>;
	SHUTDOWN_GAUGE1_VBAT_EN = <0>;
	SHUTDOWN_GAUGE1_VBAT = <3000>;
	UI_LOW_LIMIT_EN = <1>;
	UI_LOW_LIMIT_SOC0  = <(100)>;
	UI_LOW_LIMIT_VTH0  = <(32000)>;
	UI_LOW_LIMIT_SOC1  = <(200)>;
	UI_LOW_LIMIT_VTH1  = <(32500)>;
	UI_LOW_LIMIT_SOC2  = <(200)>;
	UI_LOW_LIMIT_VTH2  = <(32500)>;
	UI_LOW_LIMIT_SOC3  = <(200)>;
	UI_LOW_LIMIT_VTH3  = <(32500)>;
	UI_LOW_LIMIT_SOC3  = <(200)>;
	UI_LOW_LIMIT_VTH3  = <(32500)>;
	UI_LOW_LIMIT_SOC4  = <(200)>;
	UI_LOW_LIMIT_VTH4  = <(32500)>;
	keep-100-percent = <(1)>;
	curr-measure-20a = <(0)>;
	unit-multiple = <(1)>;
	smooth_soc_full_vol = <4500000>;
	r-fg-value = <25>;
	/* Rsense resistance */
	embedded-sel = <(1)>;
	/* Configures whether using embedded battery or not */
	pmic-shutdown-current = <(20)>;
	/* System shutdown current */
	fg-meter-resistance = <(70)>;
	/* The resistance of PCB */
	car-tune-value = <(100)>;
	/* Tune value for current measurement */
	pmic-min-vol = <(30000)>;
	/* vboot voltage for gauge 0%*/
	poweron-system-iboot = <(500)>;
	/* power on system iboot */
	shutdown-gauge0-voltage = <(30000)>;
	/* shutdown gauge 0% voltage */
	temperature-t0 = <(50)>;
	/* Battery temperature T0 */
	temperature-t1 = <(25)>;
	/* Battery temperature T1 */
	temperature-t2 = <(10)>;
	/* Battery temperature T2 */
	temperature-t3 = <(0)>;
	/* Battery temperature T3 */
	temperature-t4 = <(-10)>;
	/* Battery temperature T4 */
	temperature-t5 = <(-20)>;
	/* Battery temperature T5 */
	g-fg-pseudo100-t0 = <(100)>;
	/* Pseudo 100% percentage at T0 */
	g-fg-pseudo100-t1 = <(100)>;
	/* Pseudo 100% percentage at T1 */
	g-fg-pseudo100-t2 = <(100)>;
	/* Pseudo 100% percentage at T2 */
	g-fg-pseudo100-t3 = <(100)>;
	/* Pseudo 100% percentage at T3 */
	g-fg-pseudo100-t4 = <(100)>;
	/* Pseudo 100% percentage at T4 */
	q-max-sys-voltage-bat0 = <(3000)>;
	/* Pseudo1 for hide percentage */
	q-max-sys-voltage-bat1 = <(3000)>;
	/* Pseudo1 for hide percentage */
	q-max-sys-voltage-bat2 = <(3000)>;
	/* Pseudo1 for hide percentage */
	q-max-sys-voltage-bat3 = <(3000)>;
	/* Pseudo1 for hide percentage */
	com-fg-meter-resistance = <(70)>;
	/* compensate The resistance of PCB */
	com-r-fg-value = <(0)>;
	/* compensate R_sense resistance */
	enable-tmp-intr-suspend = <(0)>;
	/* Enable update temp when suspend */
	active-table = <(6)>;
	/* Table numbers per battery */
	multi-temp-gauge0 = <(1)>;
	/* Multi gauge0 enable */
	rbat-pull-up-volt = <(1840)>;
	io-channels = <&mt6375_auxadc MT6375_AUXADC_BATSNS>,
                      <&mt6375_auxadc MT6375_AUXADC_BATON>,
                      <&mt6375_auxadc MT6375_AUXADC_IMP>,
                      <&mt6375_auxadc MT6375_AUXADC_IMIX_R>,
                      <&mt6375_auxadc MT6375_AUXADC_VREF>,
                      <&pmic_adc (ADC_PURES_30K_MASK | AUXADC_VIN6)>;
	io-channel-names = "bat_volt", "bat_temp", "ptim_bat_volt",
                       "ptim_r", "vref","batteryID-channel";
	tran_Q_diff = <5200 5200 5200 5200>;
#include "mt6897_battery_table.dtsi"
#include "mt6897_battery_prop_dim2_ext.dtsi"
};
