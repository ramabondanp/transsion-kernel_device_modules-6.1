#include <dt-bindings/phy/phy.h>

&i2c10 {
	cps4021@30 {
		compatible = "wireless_charger,cps4021";
		reg = <0x30>;
		status = "okay";
		powergood-gpios = <&pio 210 0x0>;
		eint_wpc-gpios = <&pio 86 0x0>;
		wired-gpios = <&pio 156 0x0>;
		sleep-gpios = <&pio 211 0x0>;
		dv_vctrl-gpios = <&pio 155 0x0>;
		//tx_mode-gpios = <&pio 95 0x0>;
		//ovp_ctrl-gpios = <&pio 54 0x0>;
	};
};