&pe5{
	compatible = "tc_pe5";
	status = "okay";
	tc_chgtype = <&tc_chgtype>;
        polling_interval = <500>;
        ta_cv_ss_repeat_tmin = <25>;
        vbat_cv = <4530>;
        start_vbat_min = <3300>;
        start_vbat_max = <4400>;
        idvchg_term = <500>; // ibus 2 : 1
        idvchg_pps_term = <1200>;
        ita_level = <6850 5000 3000 2500>;
        idvchg_level_multi = <3000 5800 10000 0>;
        rcable_level = <250 300 375 500>;
        idvchg_ss_init = <1000>;
        idvchg_ss_step = <250>;
        idvchg_ss_step1 = <100>;
        idvchg_ss_step2 = <50>;
        idvchg_ss_step1_vbat = <4000>;
        idvchg_ss_step2_vbat = <4200>;
        ta_blanking = <400>;
        chg_time_max = <36000>;
	wireless_chg_time_max = <54000>;
        tta_level_def               = <0     0     0     5     25    75    75    75    75    75    75    75    75    75    80    85    90>;
        tta_curlmt                  = <(-1)  (-1)  (-1)  300   0     300   300   300   300   300   300   300   300   300   600   900   (-1)>;
        tta_recovery_area           = <1>;
        tdvchg_level_def            = <0     0     0     5     25    70    70    70    70    70    70    70    70    70    75    80    85>;
        tdvchg_curlmt               = <(-1)  (-1)  (-1)  300   0     300   300   300   300   300   300   300   300   300   600   900   (-1)>;
        tdvchg_recovery_area        = <1>;
        tbat_level_def              = <15    15    15    22    25    35    35    35    35    35    35    35    35    35    40    43    45>;
        tbat_curlmt                 = <(-1)  (-1)  0     0     0     2000  2000  2000  2000  2000  2000  2000  2000  2000  4000  5000  (-1)>;
        tbat_recovery_area          = <1>;
        tpcb_level_def              = <0     0     0     22    25    35    35    35    35    35    35    35    35    35    40    43    90>;
        tpcb_curlmt                 = <(-1)  (-1)  0     0     0     2000  2000  2000  2000  2000  2000  2000  2000  2000  4000  5000  (-1)>;
        tpcb_recovery_area          = <1>;
        tpa_level_def               = <0      0    0     22    25    38    38    38    38    38    38    38    38    38    40    43    90>;
        tpa_curlmt                  = <(-1)  (-1)  0     0     0     2000  2000  2000  2000  2000  2000  2000  2000  2000  4000  5000  (-1)>;
        tpa_recovery_area           = <1>;
        supprot_multi_level_charging;
        //tbat
        tbat_level_def_0              = <15    15    15    22    25    32    36    36    36    36    36    36    36    36    41    44    45>;
        tbat_curlmt_0                 = <(-1)  (-1)  0     0     0     2100  2100  2100  2100  2100  2100  2100  2100  2100  4100  5100  (-1)>;
        tbat_level_def_1              = <15    15    15    22    25    35    35    35    35    35    35    35    35    35    40    43    45>;
        tbat_curlmt_1                 = <(-1)  (-1)  0     0     0     2000  2000  2000  2000  2000  2000  2000  2000  2000  4000  5000  (-1)>;
        tbat_level_def_2              = <15    15    15    22    25    35    35    35    35    35    35    35    35    35    40    43    45>;
        tbat_curlmt_2                 = <(-1)  (-1)  0     0     0     2000  2000  2000  2000  2000  2000  2000  2000  2000  4000  5000  (-1)>; 
        //tpcb
        tpcb_level_def_0              = <0     0     0     22    25    32    37    37    37    37    37    37    37    37    42    45    90>;
        tpcb_curlmt_0                 = <(-1)  (-1)  0     0     0     2200  2100  2100  2100  2100  2100  2100  2100  2100  4100  5100  (-1)>;
        tpcb_level_def_1              = <0     0     0     22    25    35    35    35    35    35    35    35    35    35    40    43    90>;
        tpcb_curlmt_1                 = <(-1)  (-1)  0     0     0     2000  2000  2000  2000  2000  2000  2000  2000  2000  4000  5000  (-1)>;
        tpcb_level_def_2              = <0     0     0     22    25    35    35    35    35    35    35    35    35    35    40    43    90>;
        tpcb_curlmt_2                 = <(-1)  (-1)  0     0     0     2000  2000  2000  2000  2000  2000  2000  2000  2000  4000  5000  (-1)>;
        tpa_level_def_0               = <0      0    0     22    25    38    38    38    38    38    38    38    38    38    40    43    90>;
        tpa_curlmt_0                  = <(-1)  (-1)  0     0     0     2000  2000  2000  2000  2000  2000  2000  2000  2000  4000  5000  (-1)>;
        tpa_level_def_1               = <0      0    0     22    25    38    38    38    38    38    38    38    38    38    40    43    90>;
        tpa_curlmt_1                  = <(-1)  (-1)  0     0     0     2000  2000  2000  2000  2000  2000  2000  2000  2000  4000  5000  (-1)>;
        tpa_level_def_2               = <0      0    0     22    25    38    38    38    38    38    38    38    38    38    40    43    90>;
        tpa_curlmt_2                  = <(-1)  (-1)  0     0     0     2000  2000  2000  2000  2000  2000  2000  2000  2000  4000  5000  (-1)>;
        wireless_tbat_level_def     = <15    15    15    22    25    35    35    35    35    35    35    35    35    35    40    43    45>;
        wireless_tbat_curlmt        = <(-1)  (-1)  0     0     0     2000  2000  2000  2000  2000  2000  2000  2000  2000  4000  5000  (-1)>;
        wireless_tpcb_level_def     = <0     0     0     22    25    35    35    35    35    35    35    35    35    35    40    43    45>;
        wireless_tpcb_curlmt        = <(-1)  (-1)  0     0     0     2000  2000  2000  2000  2000  2000  2000  2000  2000  4000  5000  (-1)>;
        wireless_tpa_level_def      = <0     0     0     22    25    38    38    38    38    38    38    38    38    38    40    43    45>;
        wireless_tpa_curlmt         = <(-1)  (-1)  0     0     0     2000  2000  2000  2000  2000  2000  2000  2000  2000  4000  5000  (-1)>;
	sys_power_level_def         = <0     0     400   800   1200  1200  1600  2000  2400  2800  3200  3600  4000  4400  4800  5200  50000>;
	sys_power_curlmt            = <(-1)  (-1)  0     0     3300  3300  2800  2500  2300  2100  1900  1700  1500  1300  1300  1300  (-1)>;
	sys_power_recovery_area     = <400>;
        ifod_threshold = <200>;
        rsw_min = <20>;
        ircmp_rbat = <40>;
        ircmp_vclamp = <0>;
        support_ta = "pd_adapter";
        allow_not_check_ta_status;
        vbat_threshold = <4150>;
	rechg_tbat_high = <41>;
	rechg_tbat_low = <17>;
	project_pwr_ratio = <70>;
	project_power = <100>;
	min_ita_gap = <10>;
	ita_stable_cnt = <20>;
	vol_diff_gap = <50>;
	cable_capability_level = <0 5000 6000 9000>;
	vol_diff_level = <1000 1000 1200 1500>;
        /*wireless charger*/
        wireless_curlmt = <2000>;
        wireless_sit_shift_curlmt = <1500>;
        /*Wireless EOC*/
        idvchg_wireless_term = <500>;
        /*0:2:1 or 4:2 cp
          1:4:2:1 cp*/
        wireless_en_dual= <0>;
        wireless_vbus_max_ovp=<11000>;
        wireless_vta_cap_max=<10500>;
	pe50_wireless_vta_init = <9000>;
	pe50_wireless_ita_init = <3000>;
	pe50_vta_init = <5300>;
	pe50_ita_init = <3000>;
        run_cp_cur = <0 2500 4250 9000>;
        run_cp_recovery_gap = <0 500 750 1000>;
        run_wls_cp_cur = <0 3000 6000 10000>;
        run_wls_cp_recovery_gap = <0 200 400 600>;
        /* support_6_2; */
        /* support_4_1; */
        /* support_4_2; */
        /* support_2_1; */
        support_spec =  <0 0 0 1>;
        vta_cap_min = <6800 6800 6800 6800>;
        vta_cap_max = <30000 20000 20000 10500>;
        ita_cap_min = <1000 1000 1000 1000>;
        vbus_max_ovp = <33000 20500 20500 11000>;
        /* battery step cv param */
        pe5_ffc_gap = <20 20 20 20 20 20>;
	/* dual battery  */
	support_dual_battery;
	step_cc_gap = <100>;
	step_master_ffc_level = <2>;
	step_master_ffc_level_0 = <15 35
			    4200 4200 4200 4350 4530 4550
			    8100 8100 8100 5840 2920 2044
			    1022
			    0 0
			    0>;
	step_master_ffc_level_1 = <35 45
			    4200 4200 4200 4350 4530 4550
			    8100 8100 8100 5840 2920 2044
			    1519
			    0 0
			    0>;
	step_slave_ffc_level = <2>;
	step_slave_ffc_level_0 = <15 35
			    4200 4200 4200 4350 4530 4550
			    7150 7150 7150 5180 2590 1813
			    959
			    0 0
			    0>;
	step_slave_ffc_level_1 = <35 45                      
			    4200 4200 4200 4350 4530 4550
			    7150 7150 7150 5180 2590 1813
			    1425
			    0 0
			    0>;
        /* step_ffc_level = <6>; */
        /* step_ffc_level_0 = <15 35 */
        /*                     4200  4300  4300  4400  4500 4530 */
        /*                     20000 15750 15750 13500 9000 6750 */
        /*                     1440 */
	/*                     0 300 */
	/*                     0>; */
        /* step_ffc_level_1 = <35 45                            [> ffc temp <] */
        /*                     4200  4300  4300  4400  4500 4530      [> ffc vbat <] */
        /*                     20000 15750 15750 13500 9000 6750      [> ffc ibat <] */
        /*                     2115		             [> ffc term <] */
	/*                     0 300                            [> cycle cnt(write 0 if not supported long life) <] */
	/*                     0>;                              [> rechg gap <]   */
        /* step_ffc_level_2 = <15 35 */
        /*                     4200  4300  4300  4400  4480 4510 */
        /*                     20000 15750 15750 13500 9000 6750 */
        /*                     1440 */
	/*                     300 500 */
	/*                     20>; */
        /* step_ffc_level_3 = <35 45                            [> ffc temp <] */
        /*                     4200  4300  4300  4400  4500 4530      [> ffc vbat <] */
        /*                     20000 15750 15750 13500 9000 6750      [> ffc ibat <] */
        /*                     2115		             [> ffc term <] */
	/*                     300 500                          [> cycle cnt(write 0 if not supported long life) <] */
	/*                     20>;                             [> rechg gap <]   */
        /* step_ffc_level_4 = <15 35 */
        /*                     4200  4300  4300  4400  4460 4490 */
        /*                     20000 15750 15750 13500 9000 6750 */
        /*                     1440 */
	/*                     500 (-1) */
	/*                     40>; */
        /* step_ffc_level_5 = <35 45                            [> ffc temp <] */
        /*                     4200  4300  4300  4400  4460 4490      [> ffc vbat <] */
        /*                     20000 15750 15750 13500 9000 6750      [> ffc ibat <] */
        /*                     2115		             [> ffc term <] */
	/*                     500 (-1)                            [> cycle cnt(write 0 if not supported long life) <] */
	/*                     40>;                             [> rechg gap <]   */
	/* support_vbat_cycle_level; */
	/* support_long_life_recharger; */
};
