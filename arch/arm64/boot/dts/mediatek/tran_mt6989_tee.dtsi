// SPDX-License-Identifier: GPL-2.0-only
/*
 * Copyright (C) 2024 Transsion Inc.
 */
/* Trustonic Mobicore real driver */
&mobicore {
        trustonic,real-drv = <1>;
};

&mtee_svp {
        mtee: MTEE {
                compatible = "mediatek,mtk_svp_on_mtee_support";
        };
        svp: SecureVideoPath {
                compatible = "mediatek,mtk_sec_video_path_support";
        };
};

