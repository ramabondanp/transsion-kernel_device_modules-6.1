
&i2c8 {
    clock-frequency = <1000000>;
    aw8622x_pdlc@58{
        compatible = "awinic,8622x_pdlc";
        reg = < 0x58 >;
        aw862xx_i2c_addr = < 0x58 >;
        reset-gpio = <&pio 117 0>;
        irq-gpio = <&pio 120 0>;
        /* --------aw8622x dts info-------- */
        aw8622x_pdlc_lk_f0_cali = < 0 >;
        aw8622x_pdlc_mode = < 0 >; /* mode: RAM mode->0; CONT mode->1 */
        aw8622x_pdlc_f0_pre = < 2350 >;
        aw8622x_pdlc_f0_cali_percen = < 7 >;
        aw8622x_pdlc_cont_drv1_lvl = < 0x7F >;
        aw8622x_pdlc_cont_drv2_lvl = < 0x36 >;
        aw8622x_pdlc_cont_brk_time = < 0x06 >;
        aw8622x_pdlc_cont_tset = < 0x06 >;
        aw8622x_pdlc_cont_bemf_set = < 0x02 >;
        aw8622x_pdlc_cont_drv_width = < 0x6A >;
        aw8622x_pdlc_cont_wait_num = < 0x06 >;
        aw8622x_pdlc_cont_brk_gain = < 0x08 >;
        aw8622x_pdlc_cont_drv1_time = < 0x04 >;
        aw8622x_pdlc_cont_drv2_time = < 0x14 >;
        aw8622x_pdlc_cont_track_margin = < 0x12 >;
        aw8622x_pdlc_sine_array = < 0x05 0xB2 0xFF 0xEF >; /* SIN_H SIN_L COS_H COS_L*/
        aw8622x_pdlc_d2s_gain = < 0x05 >;
        aw8622x_pdlc_prctmode = < 0x2D 0x3E 0x3F >;
        aw8622x_pdlc_trig_config = < 1 0 1 1 1 2 0 1 0 0 1 0 2 0 1 0 0 1 0 2 0 >;
        aw8622x_pdlc_duration_time = < 30 60 90 >;
        aw8622x_pdlc_is_enabled_auto_bst;
        status = "okay";
    };
};



