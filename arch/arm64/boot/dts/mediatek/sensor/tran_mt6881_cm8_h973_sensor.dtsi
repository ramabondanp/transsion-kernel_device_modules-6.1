// SPDX-License-Identifier: (GPL-2.0 OR MIT)
/*
 * Sensor configuration for cm8_h973
 * Migrated from tran_projects cm8_h973.dts
 */

&tran_sensor_cust {
        /*lcm info for sensor start*/
        /*als sensor support state*/
        un_als_support = <1 0 0 0>;/*ML MSL SL SSL*/
        /*main sensor:ML*/
        ml_lcm_info = < 979 59 69 69>;/*offset_x, offset_y, clip_w, clip_h*/
        extra_ml_lcm_info = <1005 89 32 32 80 20>;
        /*main sub als lcm info:MSL*/
        /*lcm info for sensor end*/
		ml_nv_info = <1 1 1>; /*vendortype:SensorTek,  algotype:Cutout, version:V1_0_0*/
		nv_restore_time = <3>;
};

&irtx_pwm {
	pwm_ch = <2>;
	status = "okay";
};
