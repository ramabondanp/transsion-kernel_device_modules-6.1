&i2c3 {
	status = "okay";
	clock-frequency = <1000000>;
	#address-cells = <1>;
	#size-cells = <0>;

	aw20144_led@20 {
		compatible = "awinic,aw20144_led";
		reg = <0x20>;
		enable-gpio = <&pio 44 0>;
		aw20144,imax = <120>;
		aw20144,sl_current = <120>;
		aw20144,max_brightness = <120>;
		aw20144,effect-bin;
		ignore_open_circuit_test_cfg_size = <10>;
		ignore_open_circuit_test_cfg_reg = <0x05 0x08 0x0b 0x0e 0x11 0x14 0x17 0x18 0x19 0x1a>;
		ignore_open_circuit_test_cfg_val = <0x3f 0x3f 0x3f 0x3f 0x3f 0x3f 0x3f 0x3f 0x3f 0x3f>;
		status = "okay";
	};
};
