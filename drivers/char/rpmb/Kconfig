## drivers/char/rpmb/Kconfig
```kconfig
config RPMB
	tristate "RPMB partition interface"
	help
	  Unified RPMB partition interface for eMMC and UFS.
	  Provides interface for in kernel security controllers to
	  access RPMB partition.

	  If unsure, select N.

config TRAN_ENABLE_RPMB
    tristate "Enable tran rpmb"
    default n
    help
      enable tran rpmb
```

## drivers/gpu/drm/mediatek/mediatek_v2/Kconfig
```kconfig
config DRM_MEDIATEK_V2
	bool "Version 2 of DRM Support for Mediatek SoCs"
	help
	  Choose this option if you have a phone Mediatek
	  SoCs. The module will be called mediatek-drm v2
	  This driver provides kernel mode setting and
	  buffer management to userspace.

config DRM_MTK_DISABLE_AEE_LAYER
	bool "Disable AEE Layer for the customer who don't want to produce AEE"
	help
	  Disable AEE Layer if you do not want to produce AEE.
	  Default Mediatek SoCs will produce AEE when exception occurred.
	  If this value is y, will not produce AEE.
	  If this value is n, will produce AEE.
	  If you do not produce AEE, please set it to Y in xxx_defconfig.

config MTK_AAL_SUPPORT
	bool "Support MTK ambient-light adaptive luma (AAL)"
	help
	  Decide whether to support ambient-light adaptive luma and
	  display visual enhancement.
	  This feature requires the cowork of AAL user-space algorithm process.

config MTK_DRE30_SUPPORT
	bool "Support DRE 30"
	help
	  Decide whether to support ambient-light adaptive luma and
	  display visual enhancement ver.3.
	  This feature requires the cowork of AAL user-space algorithm process.

config MTK_DISP_LOGGER
	bool "Default enable display logger function"
	help
	  Display logger would record display-related event
	  for debug purpose.
	  If this value is Y, display driver would
	  initial display loggger during driver probe
	  stage, but can still manual disable this function
	  through debugfs or procfs.

config MTK_DISPLAY_DUAL_PIPE_DUAL_PORT_SUPPORT
	bool "support lcm dual pipe and dual dsi port"
	help
	  This config decide if device support lcm dual pipe and dual dsi port
	  If dsi support dual port, dual dsc may also should support
	  If this value is Y, display maybe dual pipe
	  If dsi support dual port, each dsi could calculate lower mmclk, and
	  support more types lcm

config MTK_DISP_DEBUG
	bool "Support display debug function, default disable in user load"
	help
	  Used to debug for display module, only needed by developers.
	  The function sould be disabled in user load for security.

config TRANSSION_CWB_API_SUPPORT
	tristate "add CWB api for sensor "
	help
		Specific code for cwb api .

config TRANSSION_CWB_HIGH_PERFORMANCE
	tristate "add CWB api for sensor "
	depends on TRANSSION_CWB_API_SUPPORT
	help
		Specific code for cwb api .

config TRAN_LHBM_NOTIFY_FINGERPRINT
	tristate "enable hbm state notify fingerprint"
	help
	  For fingerprint under the screen projects.
	  You need add CONFIG_TRAN_LHBM_NOTIFY_FINGERPRINT=m to tran_custom.config file.

config CUSTOM_TRAN_PROJECT
    string "CUSTOM_TRAN_PROJECT"
        help
           Kernel space tran project.

config TRANSSION_DOZE_BRIGHTNESS_SUPPORT
	tristate "add doze brightness adjust "
	help
		Specific code for doze brightness .
config TRAN_LCD_AOD_ENTER_NOTIFY_SUPPORT
	tristate "lcd_aod_enter_notify "
	help
		Specific code for LCD AOD
config TRAN_ALWAYS_NOTIFY_LCM_COLOR_MODE
	tristate "enable always notify lcm color mode to framework "
	help
	  You need add CONFIG_TRAN_ALWAYS_NOTIFY_LCM_COLOR_MODE=m to tran_custom.config file.

config TRAN_DYNAMIC_WCG
	tristate "enable dynamic wcg"
	help
	  You need add CONFIG_TRAN_DYNAMIC_WCG=m to tran_custom.config file.
```

## drivers/input/fingerprint/Kconfig
```kconfig
#
#Fingerprint
#
menu "Fingerprint support"
	depends on INPUT
config TRAN_FINGERPRINT
	tristate "Tran Fingerprint"
	depends on DEVICE_MODULES_SPI_MT65XX
	default n
	help
	TRAN fingerprint chip.
config MTK_FINGERPRINT_SUPPORT
	tristate "Mediatek Fingerprint"
	default y
	help
	  Fingerprint mtk driver enable/disable
	  in the kernel.Say Y here if you want to
	  use mediatek fingerprint driver,fingerprint
	  driver will support fingerprint function

endmenu
source "$(KCONFIG_EXT_PREFIX)/drivers/input/fingerprint/tran_common_v2/Kconfig"
```

## drivers/input/fingerprint/tran_common_v2/Kconfig
```kconfig
menuconfig TRAN_FINGERPRINT
	tristate "transsion class series devices"
	default n

if TRAN_FINGERPRINT

config TRAN_FP_DRV_MODE_SPI
	bool "specify fingerprint driver type --- SPI mode"
	default y
	help
		support for spi mode fingerprint driver

config TRAN_FP_LOG_LVL
	string "which log level does transsion fp support?"
	default "DEBUG"
	help
		support for transsion fp log output control
config TRAN_FP_ANDROID_VERSION
	string "finger android version"
	default "android_s"
	help
		finger android version
endif
```

## drivers/input/keyboard/Kconfig
```kconfig
# SPDX-License-Identifier: GPL-2.0-only
#
# Input core configuration
#

if INPUT_KEYBOARD

config KEYBOARD_MTK_KPD
	tristate "MediaTek Keypad Support"
	depends on OF && HAVE_CLK
	help
	  Say Y here if you want to use the keypad on MediaTek SoCs.
	  If unsure, say N.
	  To compile this driver as a module, choose M here: the
	  module will be called mtk-kpd.

config DEVICE_MODULES_KEYBOARD_MTK_PMIC
	tristate "MediaTek PMIC keys support"
	depends on DEVICE_MODULES_MFD_MT6397
	help
	  Say Y here if you want to use the pmic keys (powerkey/homekey).

	  To compile this driver as a module, choose M here: the
	  module will be called mtk-pmic-keys.

config TRAN_AI_KEY_SUPPORT
	tristate "tran AI key support"
	depends on KEYBOARD_MTK_KPD
	help
	  Say Y here if you want to use the KPCOL1 as AI key on mt6897.

	  To compile this driver as a module, choose M here: the
	  module will be called.

endif
source "$(KCONFIG_EXT_PREFIX)drivers/input/keyboard/aw9620x/Kconfig"
```

## drivers/input/touchscreen/transsion/Kconfig
```kconfig
# SPDX-License-Identifier: GPL-2.0-only
#
# Touchscreen driver configuration
#

# core
source "$(KCONFIG_EXT_PREFIX)drivers/input/touchscreen/transsion/core/Kconfig"

# vendor
source "$(KCONFIG_EXT_PREFIX)drivers/input/touchscreen/transsion/vendor/Kconfig"
```

## drivers/input/touchscreen/transsion/core/Kconfig
```kconfig
config TRAN_TOUCH_CORE
    tristate "Transsion touch core"
    default m
    help
      Transsion touch core is always built as a module.
```

## drivers/input/touchscreen/transsion/vendor/Kconfig
```kconfig
source "$(KCONFIG_EXT_PREFIX)drivers/input/touchscreen/transsion/vendor/goodix/Kconfig"
source "$(KCONFIG_EXT_PREFIX)drivers/input/touchscreen/transsion/vendor/focaltech/Kconfig"
source "$(KCONFIG_EXT_PREFIX)drivers/input/touchscreen/transsion/vendor/omnivision/Kconfig"
```

## drivers/input/touchscreen/transsion/vendor/focaltech/Kconfig
```kconfig
config TRAN_FT3683G_SPI
    tristate "Transsion ft3683g touch ic"
    default m
    help
      Transsion ft3683g driver is always built as a module.

config FTS_THREE_IN_ONE
    bool "Focaltech FTS_THREE_IN_ONE"
    default n
    help
      Say Y here if you have Focaltech touch panel.
      If unsure, say N.

config TRAN_FOCALTECH_NO_FLASH_COMMON
    tristate "CONFIG_TRAN_FOCALTECH_NO_FLASH_COMMON"
    default m
    help
      Transsion focaltech no-flash driver is always built as a module.
```

## drivers/input/touchscreen/transsion/vendor/goodix/Kconfig
```kconfig
config TRAN_GT9916_SPI
    tristate "Transsion gt9916 touch ic"
    default m
    help
      Transsion gt9916 driver is always built as a module.
```

## drivers/input/touchscreen/transsion/vendor/omnivision/Kconfig
```kconfig
config TRAN_TD4160_SPI
    tristate "Transsion td4160 touch ic"
    default m
    help
      Transsion td4160 driver is always built as a module.

config TRAN_TD4376_SPI
    tristate "Transsion td4376 touch ic"
    default m
    help
      Transsion td4376 driver is always built as a module.
```

## drivers/leds/aw862xx/Kconfig
```kconfig
#
# AWINIC_NV Driver
#

config AWINIC_NV
	tristate "Awinic pdlc nv driver"
	depends on I2C
	help
	  Say Y here if you have Awinic pdlc nv controller
	  chip in your system.
	  If unsure, say N.
	  To compile this driver as a module, choose M here: the
	  module will be called awinic_nv driver.
```

## drivers/leds/tran_leds_pdlc/Kconfig
```kconfig
config TC_LEDS_PDLC
        tristate "enable Polymer Dispersed Liquid Crystal func"
    default n
    help
        enable Polymer Dispersed Liquid Crystal func.
        If you need this func, set it to Y.
```

## drivers/misc/hiber/Kconfig
```kconfig
config TRAN_HIBER_SUPPORT
	tristate "hiber additional support"
        default m
	help
	  Enable hiber additional support
```

## drivers/misc/mediatek/cam_cal/Kconfig
```kconfig
config MTK_CAM_CAL
	tristate "MTK camera cal driver"
	help
	  This module is used for reading calibration data of camera which
	  stored in EEPROM component.
	  CONFIG_MTK_CAM_CAL define if the camera cal driver should be
	  built in or not. If you want to use EEPROM which contains
	  calibration data for sensor. You have enable CONFIG_MTK_CAM_CAL
	  on ProjectConfig. The kernel space for EEPROM will be build.
	  It may be like as "/dev/camera_eeprom0".
	  User space code will control the driver by open and read this one.

config MTK_V4L2_CAM_CAL
	tristate "MTK camera cal driver"
	help
	  This module is used for reading calibration data of camera which
	  stored in EEPROM component.
	  CONFIG_MTK_V4L2_CAM_CAL define if the camera cal driver should be
	  built in or not. If you want to use EEPROM which contains
	  calibration data for sensor. You have enable CONFIG_MTK_V4L2_CAM_CAL
	  on ProjectConfig. The kernel space for EEPROM will be build.
	  It may be like as "/dev/camera_eeprom0".
	  User space code will control the driver by open and read this one.

config CUSTOM_TRAN_PCBA
    string "CUSTOM_TRAN_PCBA"
       help
              Kernel space PCBA version.
config CUSTOM_TRAN_PROJECT
    string "CUSTOM_TRAN_PROJECT"
       help
              Kernel space tran project.
config CUSTOM_TRAN_CAM_MATERIAL_CODE
    string "CUSTOM_TRAN_CAM_MATERIAL_CODE"
    help
    Kernel space image sensor material code. Define project used all image
    sensors material code.
config TRAN_SHUBOIS
	bool "sensorHub OIS support"
	help
	  Kernel space sensorHub OIS support.
```

## drivers/misc/mediatek/hall_holster/Kconfig
```kconfig
# SPDX-License-Identifier: GPL-2.0

config TRAN_HALL_HOLSTER
    tristate "Support holster hall"
    default n
    help
      Say Y here if you have holster hall.
      If unsure, say N.
      To compile this dirver as a module, choose M here: the
      module will be called.
```

## drivers/misc/mediatek/hall_rlk/Kconfig
```kconfig
# SPDX-License-Identifier: GPL-2.0

config MTK_LINE_HALL
    tristate "CONFIG_MTK_LINE_HALL"
    default n
    help
      Say Y here if you have line hall.
      If unsure, say N.
      To compile this dirver as a module, choose M here: the
      module will be called.
config HOLSTER_HALL
    tristate "CONFIG_HOLSTER_HALL"
    default n
    help
      Say Y here if you have line hall.
      If unsure, say N.
      To compile this dirver as a module, choose M here: the
      module will be called.
```

## drivers/misc/mediatek/irtx/Kconfig
```kconfig
config MTK_IRTX_PWM_SUPPORT
	tristate "Mediatek PWM IR transmitter"
	depends on RC_CORE
	depends on ARCH_MEDIATEK
	depends on MTK_PWM
	help
	   Say Y if you want to use the PWM IR transmitter
	   on Mediatek SoCs.

	   To compile this driver as a module, choose M here: the
	   module will be called mtk-irtx-pwm.

config IR_LED_EXTERNAL_LDO
	tristate "IR transmitter use extern ldo"
	default n

config IR_LED_USE_VBAT_POWER
	tristate "IR transmitter use vbat power"
	default n
    
config IR_LED_GPIO_CTRL_LDO
	tristate "IR transmitter use gpio control ldo"
	default n
```

## drivers/misc/mediatek/sensor/2.0/sensor_debug/Kconfig
```kconfig
config TRAN_SENSOR_DEBUG
    tristate "For sensor debug support"
    help
        Select for sensor debug function.
        Set m or to select this feature for the item,
        and set n to disable.
```

## drivers/misc/mediatek/sensor/2.0/sensorhub/Kconfig
```kconfig
config MTK_SENSORHUB
	tristate "sensorhub architecture for MediaTek package"
	help
	  It support mediatek sensorhub architecture.
	  If this option is set,
	  it will support
	  mediatek sensorhub architecture.
config TRAN_GET_BRIGHTNESS_LEVEL_SUPPORT
	tristate "For SCP get brightness level function"
	help
		Select for SCP get brightness level function.
		Set Y or to select this feature for the item,
		and set N to disable.

config TRAN_CWB_SUPPORT
	tristate "For SCP enabel CWB async enable function"
	help
		Select for SCP enabel CWB async enable function.
		Set M or to select this feature for the item,
		and set N to disable.

config TRAN_SCP_EE_SUPPORT
	tristate "For SCP ee"
	help
		Select for SCP ee function.
		Set Y or to select this feature for the item,
		and set N to disable.

config TRAN_GET_VREFRESH_SUPPORT
	tristate "For SCP get vrefresh function"
	help
		Select for SCP  get vrefresh function.
		Set M or to select this feature for the item,
		and set N to disable.

config SENSOR_GET_SCREEN_POWER_STATE
	tristate "For SCP get screen state function"
	help
		Select for SCP  get screen state function.
		Set M or to select this feature for the item,
		and set N to disable.
config TRAN_CHARGER_POLL
	tristate "For SCP charger function"
	help
		Select for SCP charger function.
		Set Y or to select this feature for the item,
		and set N to disable.

config SENSOR_GET_LCM_INFO
	tristate "For SCP get screen state function"
	help
		Select for SCP  get screen state function.
		Set Y or to select this feature for the item,
		and set N to disable.
```

## drivers/misc/mediatek/sensor/hr_spo2/tran_hr_spo2/Kconfig
```kconfig
config TRAN_HR_SPO2
    tristate "CONFIG_TRAN_HR_SPO2"
    default n
    help
       transsion hr_spo2 driver
```

## drivers/misc/mediatek/tetras_aiisp/linux-ext/i2c2apb/Kconfig
```kconfig
# SPDX-License-Identifier: GPL-2.0-only
config TETRAS_I3C2APB
	tristate "tetras i3c2apb driver"
	depends on I3C
	default m
	help
	  Enable this driver if you want to support tetras i3c2apb block.
```
