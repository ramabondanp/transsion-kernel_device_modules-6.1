## kernel/configs/x6856b_h971_defconfig
```kconfig
CONFIG_IR_LED_USE_VBAT_POWER=y
CONFIG_RC_CORE=y
CONFIG_LIRC=y
CONFIG_CUSTOM_KERNEL_IMGSENSOR="imx896_mipi_raw gc32e1_mipi_raw gc08a8wide_mipi_raw fake_serial_yuv"
CONFIG_CUSTOM_TRAN_CAM_MATERIAL_CODE="imx896_17201919 gc32e1_17201856 gc08a8wide_17201942 alspdt17_17201873"
CONFIG_MTK_PLATFORM="mt6897"
CONFIG_REGULATOR_FIXED_VOLTAGE=y
CONFIG_CUSTOM_TRAN_PROJECT="tran_x6856b"
CONFIG_MTK_FLASHLIGHT_PT=n
CONFIG_TRAN_CAMERA_FAKE_STEREO_MAIN3=y
CONFIG_TRAN_SHUBOIS=y
CONFIG_TRAN_ENABLE_RPMB=y


CONFIG_TRANSSION_DYNAMIC_BIND_CPU=y
CONFIG_TRANSSION_MCQ=y
CONFIG_TRANSSION_BLK_UAS=y
CONFIG_TRAN_DISABLE_RECORD_INFO=y
CONFIG_TRANSSION_BLK_PERF_OPT=y
CONFIG_TRAN_HX3918_G_SENSOR=y
CONFIG_HOLSTER_HALL=y
CONFIG_TRAN_GET_BRIGHTNESS_LEVEL_SUPPORT=y
CONFIG_MTK_TINYSYS_SCP_DEBUG_SUPPORT=y
CONFIG_TRANS_SCHED_SHARE=y
CONFIG_TRAN_TOSPANIC_DEBUG_SUPPORT=y
CONFIG_TRAN_SYSTEM_SERVER_LOAD=y
CONFIG_TRAN_HEALTH_TNE=y

CONFIG_TRAN_PNP_GAME_CTL=y
CONFIG_TRAN_HBM_THERMAL_CTL=y
CONFIG_ZRAM_WRITEBACK=y
CONFIG_TRAN_MEMORY_FUSION2_2_SUPPORT=y

CONFIG_NET_SCH_INGRESS=y
CONFIG_NET_CLS_FW=y
CONFIG_NET_CLS_FLOW=y
CONFIG_NET_ACT_POLICE=y
CONFIG_NET_ACT_MIRRED=y
CONFIG_NET_ACT_IPT=y
CONFIG_NET_CLS_IND=y
CONFIG_IFB=y
CONFIG_SDCARD_FS=y
CONFIG_MTK_MD3_SUPPORT=0
CONFIG_MTK_C2K_LTE_MODE=0
CONFIG_TRAN_CHARGER_POLL=y
CONFIG_MTK_WIFI_6G_SUPPORT=y
CONFIG_MTK_VOW_MAX_PDK_NUMBER=1
CONFIG_MTK_VOW_BARGE_IN_SUPPORT=y
CONFIG_MTK_VOW_GVA_SUPPORT=y
```

## kernel/configs/x6873_h972_defconfig
```kconfig
CONFIG_IR_LED_USE_VBAT_POWER=y
CONFIG_RC_CORE=y
CONFIG_LIRC=y
CONFIG_CUSTOM_KERNEL_IMGSENSOR="s5khm2sp_mipi_raw s5khm6sx_mipi_raw gc13a0_mipi_raw gc08a8wide_mipi_raw"
CONFIG_CUSTOM_TRAN_CAM_MATERIAL_CODE="s5khm2sp_17201963 s5khm6sx_17201842 gc13a0_17201930 gc08a8wide_17201942"
CONFIG_MTK_PLATFORM="mt6897"
CONFIG_REGULATOR_FIXED_VOLTAGE=y
CONFIG_CUSTOM_TRAN_PROJECT="tran_x6873"
CONFIG_TRAN_SHUBOIS=n
CONFIG_MTK_FLASHLIGHT_PT=n
CONFIG_MTK_FLASHLIGHT_TWO_SUPPLY=y
CONFIG_TRAN_ENABLE_RPMB=y
CONFIG_TRANSSION_DYNAMIC_BIND_CPU=y
CONFIG_TRANSSION_MCQ=y
CONFIG_TRANSSION_BLK_UAS=y
CONFIG_TRAN_DISABLE_RECORD_INFO=y
CONFIG_TRANSSION_BLK_PERF_OPT=y
CONFIG_TRAN_GET_BRIGHTNESS_LEVEL_SUPPORT=y
CONFIG_MTK_TINYSYS_SCP_DEBUG_SUPPORT=y
CONFIG_TRANS_SCHED_SHARE=y
CONFIG_TRAN_TOSPANIC_DEBUG_SUPPORT=y
CONFIG_TRAN_SYSTEM_SERVER_LOAD=y
CONFIG_TRAN_HEALTH_TNE=y
CONFIG_ZRAM_WRITEBACK=y
CONFIG_TRAN_MEMORY_FUSION2_2_SUPPORT=y
CONFIG_NET_SCH_INGRESS=y
CONFIG_NET_CLS_FW=y
CONFIG_NET_CLS_FLOW=y
CONFIG_NET_ACT_POLICE=y
CONFIG_NET_ACT_MIRRED=y
CONFIG_NET_ACT_IPT=y
CONFIG_NET_CLS_IND=y
CONFIG_IFB=y
CONFIG_SDCARD_FS=yCONFIG_MTK_MD3_SUPPORT=0
CONFIG_MTK_C2K_LTE_MODE=0
CONFIG_TRAN_SAR_DEBUG=y
CONFIG_AW_ACCDET_PLUG_CAIL=y
CONFIG_AW_USB_PLUG_CAIL=y
CONFIG_TRAN_HBM_THERMAL_CTL=y
CONFIG_MTK_WIFI_6G_SUPPORT=y
CONFIG_MTK_VOW_MAX_PDK_NUMBER=1
CONFIG_MTK_VOW_BARGE_IN_SUPPORT=y
CONFIG_MTK_VOW_GVA_SUPPORT=y
CONFIG_AWINIC_86224_LIGHT=y
```

## kernel/configs/x6876_h786_nonfc_defconfig
```kconfig
CONFIG_TRAN_TOSPANIC_DEBUG_SUPPORT=y
CONFIG_TRAN_ENABLE_RPMB=y
CONFIG_TRAN_SYSTEM_SERVER_LOAD=y
CONFIG_TRAN_HEALTH_TNE=y
CONFIG_TRANS_SCHED_SHARE=y

CONFIG_TRAN_HBM_THERMAL_CTL=y
CONFIG_CUSTOM_KERNEL_IMGSENSOR="imx682_mipi_raw gc13a0ff_mipi_raw gc08a8wide_mipi_raw"
CONFIG_CUSTOM_TRAN_CAM_MATERIAL_CODE="imx682_17201926 gc13a0_17201930 gc08a8wide_17201942"
CONFIG_MTK_PLATFORM="mt6878"
CONFIG_REGULATOR_FIXED_VOLTAGE=y
CONFIG_CUSTOM_TRAN_PROJECT="tran_x6876"
CONFIG_MTK_FLASHLIGHT_PT=n
CONFIG_TRAN_GET_BRIGHTNESS_LEVEL_SUPPORT=y
CONFIG_IR_LED_USE_VBAT_POWER=y
CONFIG_RC_CORE=y
CONFIG_LIRC=y
CONFIG_MTK_TINYSYS_SCP_DEBUG_SUPPORT=y
CONFIG_TRAN_SAR_DEBUG=y
CONFIG_AW_USB_PLUG_CAIL=y
CONFIG_AW_ACCDET_PLUG_CAIL=y

CONFIG_NET_SCH_INGRESS=y
CONFIG_NET_CLS_FW=y
CONFIG_NET_CLS_FLOW=y
CONFIG_NET_ACT_POLICE=y
CONFIG_NET_ACT_MIRRED=y
CONFIG_NET_ACT_IPT=y
CONFIG_NET_CLS_IND=y
CONFIG_IFB=y
CONFIG_SDCARD_FS=y
CONFIG_MTK_MD3_SUPPORT=0
CONFIG_MTK_C2K_LTE_MODE=0
CONFIG_ZRAM_WRITEBACK=y
CONFIG_TRAN_MEMORY_FUSION2_2_SUPPORT=y
```

## sound/soc/transsion/Kconfig
```kconfig
# SPDX-License-Identifier: GPL-2.0-only

menu "transsion CODEC drivers"

config SND_SMARTPA_AW883XX
    tristate "SoC Audio for awinic aw883xx series"
    depends on I2C
    help
      This option enables support for aw883xx series Smart PA.

config SND_SOC_FS1589
    tristate "SoC Audio for FS1589 Smart K PA"
    depends on I2C
    help
      This option enables support for FS1589 Smart K PA.

config SND_SOC_FS1589_FW
    tristate "SoC Audio for FS1589 Smart K PA"
    depends on I2C
    help

config SND_SOC_FS1599
    tristate "SoC Audio for FS1599 Smart K PA"
    depends on I2C
    help
      This option enables support for FS1599 Smart K PA.

config USB_SWITCH_WAS4783C
    tristate "WAS4783C USB Switch"
    depends on I2C
    help
      The WAS4783C is a USB port accessory detector and switch.
      The WAS4783C is fully controlled using I2C and enables USB data,
      stereo and mono audio, video, microphone and UART data to use
      a common connector port.

config USB_SWITCH_SPLIT
    tristate "USB Split Switch"
    help
      enables USB data, stereo and mono audio, video, microphone
      and UART data to use a common connector port.

config USB_SWITCH_DIO1520
    tristate "DIO1520 USB Switch"
    help
      The DIO1520 is a USB port accessory detector and switch.
      The DIO1520 is fully controlled using I2C and enables USB data,
      stereo and mono audio, video, microphone and UART data to use
      a common connector port.

config SMARTPA_RESETGPIO_CONNECT_AW95016
    tristate "smart pa reset-gpio connect to aw95016"
    depends on I2C
    help
      if smart pa reset-gpio connect to aw95016, please enable here.

config TRAN_AUDIO_CONTROL
    tristate "TRAN AUDIO CONTROL"

config SND_SOC_AW87XXX
	tristate "SoC Audio for awinic AW87XXX Smart K PA"
	depends on I2C
	help
	  This option enables support for AW87XXX Smart K PA.

config FOUR_AW87XXX_PA
	tristate "Number of awinic AW87XXX Smart K PA"
	depends on SND_SOC_AW87XXX
	help
	  This option set four AW87XXX Smart K PA.

config SND_SOC_OCA72XXX
	tristate "SoC Audio for ocs OCA72XXX Smart K PA"
	depends on I2C
	help
	  This option enables support for OCA72XXX Smart K PA.

config USB_SWITCH_HL1280
	tristate "HL1280 USB Switch"
	depends on I2C
	help
	  This is a USB port accessory detector and switch.
	  This is fully controlled using I2C and enables USB data
endmenu

menu "Ultra Configs"
config TRAN_ELLIPTIC_ULTRASOUND_PROXIMITY
	tristate "CONFIG_TRAN_ELLIPTIC_ULTRASOUND_PROXIMITY"
	default n
	help
	  Say Y here if you have ELLIPTIC ULTRASOUND.
	  If unsure, say N.
	  To compile this dirver as a module, choose M here: the
	  module will be called.
endmenu # Ultra
```
