## drivers/power/supply/transsion/Kconfig
```kconfig
# SPDX-License-Identifier: GPL-2.0-only

config TC_CHARGER
	tristate "transsion charger support"
	default m
	help
	Say Y or N

config TC_CHARGER_TYPE_DETECT
	tristate "Mediatek Charger Type Detect Driver"
	depends on TCPC_CLASS
	help
	  Say Y here to enable Mediatek Charger Type Detect.
	  Support enable charger type detect when receiving
	  typec attach notify.
	  Say N to disable.

config TC_PE20
	tristate "MediaTek PUMP EXPRESS PLUS 2.0"
	depends on TC_CHARGER
	help
	  Fast charging technology using switch charger and current pattern
	  to achive better charging ability. It has higher charging efficiency
	  and has better thermal performance than PE+.
	  Set Yes to enable PE+2.0
	  Set No to disable PE+2.0

config TC_PD
	tristate "Transsion PD FIX protocol"
	depends on TC_CHARGER
	help
	  Set Yes to enable PD
	  Set No to disable PD

config TC_PUMP_EXPRESS_50_SUPPORT
	tristate "MediaTek PUMP EXPRESS PLUS 2.0"
	depends on TC_CHARGER
	help
	  Fast charging technology using switch charger and current pattern
	  to achive better charging ability. It has higher charging efficiency
	  and has better thermal performance than PE+.
	  Set Yes to enable PE50
	  Set No to disable PE50

config TC_TA_CLASS
	tristate "Charger Driver for transsion adapter class"
	default n

config TCHARGER_HL7138
	tristate "HL7138 charger pump IC driver"
	default n

config TCHARGER_HL7139A
	tristate "HL7139A charger pump IC driver"
	default n

config TCHARGER_SC8565
	tristate "Charger Driver for sc8565 Charger Pump IC"
	default n

config TCHARGER_SC8548
	tristate "Charger Driver for sc8565 Charger Pump IC"
	default n

config TC_GAUGE
	tristate "mid hal transsion gauge driver"
	default n
	help
		Say Yes to enable TC GAUGE driver.
		Provides mid hal for gauge.

config TC_BATTERY
	tristate "third battery driver"
	default n
	help
		Say Yes to enable TRAN_BATTERY driver.
		Provides mid hal for gauge.

config TC_PMIC
	tristate "mid hal transsion gauge driver"
	default n
	help
		Say Yes to enable TC PMIC driver.
		Provides mid hal for PMIC.

config TC_AUDIO
	tristate "mid hal transsion audio driver"
	default n
	help
		Say Yes to enable TC audio driver.
		Provides mid hal for audio.

config TCHARGER_RT9471
	tristate "Charger Driver for Richtek RT9471 Charger IC"
	default n
	depends on TC_CHARGER
	help
		Say Yes to enable Richtek RT9471 driver.
		It is mainly used as cap divider charger
		for Mediatek Pump Express 5.0.
		It depends on config TC_CHARGER

config TCHARGER_USB_SWITCH
	tristate "Charger Driver for transsion usb switch driver"
	default n

config TC_CLASS_SUPPORT
	tristate "Transsion class interface"
	default n
	depends on TC_CHARGER

config TC_MISC_INTF
	tristate "Misc interface"
	default n
	depends on TC_CHARGER
	help
		Say Yes to enable TC MISC driver.
		Provides are called by other modules.
		It depends on config TC_CHARGER

config TC_LCD_NOTIFY
	tristate "LCD NOTIFY"
	default n
	help
		Say Yes to enable LCD NOTIFY driver.
		Provides are called by other modules.

config TC_AMBIENT_DETECTION
	tristate "TC_AMBIENT_DETECTION"
	default n
	help
		Say Yes to enable TC_AMBIENT_DETECTION driver.
		Provides are called by other modules.

config TC_PID_CHARGER
	tristate "TC_PID_CHARGER"
	default n
	help
		Say Yes to enable TC_PID_CHARGER driver.
		Provides are called by other modules.

config TC_TEMP_FORECAST
	tristate "TC_TEMP_FORECAST"
	default n
	help
		Say Yes to enable TC_TEMP_FORECAST driver.
		Provides are called by other modules.

config TC_USB_CONTROL
	tristate "Transsion USB Controllerl"
	default n
	depends on TC_CHARGER

config TC_OTG_CONTROL
	tristate "Transsion OTG Controllerl"
	default n
	depends on TC_CHARGER && TCPC_CLASS

config TCHARGER_SC8950
	tristate "Charger Driver for SC8950 Charger IC"
	default n
	depends on TC_CHARGER
	help
		This is southchip switch ic.

config TCHARGER_SGM41516D
	tristate "Charger Driver for sgm41516d Charger IC"
	default n
	depends on TC_CHARGER
	help
		This is SGMICRO switch ic.

config TC_BQ27Z561
	tristate "Gauge Driver for bq27z561 IC"
	default n
	depends on TC_CHARGER
	help
		This is TI ic.

config TC_FUEL_GAUGE_NFG1000
	tristate "tran battery gauge system for NFG"
	default n
	depends on TC_CHARGER
	help
		This is TI ic.

config TC_FUEL_GAUGE_NFG1000_OTA
	tristate "tran battery gauge system for NFG upgrade"
	default n
        depends on TC_FUEL_GAUGE_NFG1000
	help
	  Say Y to enable support for transsion fuel gauge system

config TC_SC760X
	tristate "Gauge Driver for TC_SC760X IC"
	default n
	depends on TC_CHARGER
	help
		This is TI ic.

config TC_CHARGE_TRANSFER
	tristate "Transsion Charge Transfer"
	default n
	depends on TC_CHARGER
	
config TC_AUTO_TEST
	tristate "TC_AUTO_TEST"
	default n
	depends on TC_CHARGER
	help
		Say Yes to enable TC_AUTO_TEST driver.
		Provides are called by other modules.

config TC_ADAPTER_CONTROL
	tristate "TC_ADAPTER_CONTROL"
	default n
	depends on TC_CHARGER
	help
		Say Yes to enable TC_ADAPTER_CONTROL driver.
		Provides are called by other modules.

config TC_PORT_CORROSION
	tristate "TypeC port Corrosion Prevention"
	default n
	help
          Select this to port Corrosion

config TC_PORT_BURNING
	tristate "CONFIG_PORT_BURNING"
	default n
	help
	  This is port burn function.

config TC_PHY_INSERT_DET
	tristate "CONFIG_PHY_INSERT_DET"
	default n
	help
	  This is phy det function.

config TC_WATER_DETECTION
	tristate "Transsion Water Detection"
	default n
	depends on TC_CHARGER

config TC_WIRELESS_CHARGER
	tristate "TC_WIRELESS_CHARGER"
	default n
	depends on TC_CHARGER

config TC_CHARGER_MT6375
	tristate "Transsion Charger mt6375"
	default n
	depends on TC_CHARGER

config TRAN_BOOST_HL7603
	tristate "TRAN_BOOST_HL7603"
	default n
	depends on TC_CHARGER
	help
		This is tran low battery  boost IC support.

config TRAN_AGING_KOM
	bool "add tran kom control charger"
	default n

config BAT_AUTHON
	tristate "BAT_AUTHON"
	default n
	help
		This is tran battery authon.

source "$(KCONFIG_EXT_PREFIX)drivers/power/supply/transsion/wireless/Kconfig"
source "$(KCONFIG_EXT_PREFIX)drivers/power/supply/transsion/leds/Kconfig"
```

## drivers/power/supply/transsion/leds/Kconfig
```kconfig
config TC_LEDS_CLASS
        tristate "enable tc leds class"
    help
        For legacy aal project to set aal_enable when first set backlight.
        If you need this func, set it to Y.

source "$(KCONFIG_EXT_PREFIX)drivers/power/supply/transsion/leds/leds-aw22xxx/Kconfig"
source "$(KCONFIG_EXT_PREFIX)drivers/power/supply/transsion/leds/tran_leds_aw2023/Kconfig"
source "$(KCONFIG_EXT_PREFIX)drivers/power/supply/transsion/leds/tran_leds_aw20144/Kconfig"
source "$(KCONFIG_EXT_PREFIX)drivers/power/supply/transsion/leds/tran_leds_aw210xx/Kconfig"
source "$(KCONFIG_EXT_PREFIX)drivers/power/supply/transsion/leds/tran_leds_hk32f0301/Kconfig"
```

## drivers/power/supply/transsion/leds/leds-aw22xxx/Kconfig
```kconfig
config TC_LEDS_AW22XXX
	tristate "LED Support for AW22XXX"
	help
		this option enables support for the AW22XXX RGB LED connected
		through I2C. Say Y to enable support for the AW22XXX LED
```

## drivers/power/supply/transsion/leds/tran_leds_aw20144/Kconfig
```kconfig
config TC_LEDS_AW20144
	tristate "LED Support for AW20144"
	depends on LEDS_CLASS && I2C
	help
	  this option enables support for the AW20144 RGB LED connected
	  through I2C. Say Y to enable support for the AW20144 LED
	  light automatically.
```

## drivers/power/supply/transsion/leds/tran_leds_aw2023/Kconfig
```kconfig
config TC_LEDS_AW2023
	tristate "LED Support for AW2023"
	help
		this option enables support for the AW2023 RGB LED connected
		through I2C. Say Y to enable support for the AW2023 LED
```

## drivers/power/supply/transsion/leds/tran_leds_hk32f0301/Kconfig
```kconfig
config TC_LEDS_HK320F0301
	tristate "LED Support for HK320F0301"
	depends on LEDS_CLASS && I2C
	help
	  this option enables support for the HK320F0301 RGB LED connected
	  through I2C. Say Y to enable support for the HK320F0301 LED
	  light automatically.
```

## drivers/power/supply/transsion/wireless/Kconfig
```kconfig
config CHARGER_CPS4021
	tristate "Charger Driver for cps4021 Charger IC"
	default n
    depends on TC_CHARGER

config CHARGER_MT5728
	tristate "Charger Driver for mt5728 Charger IC"
	default n
    depends on TC_CHARGER

config WIRELESS_MANAGER
	tristate "Charger Driver for wireless common algo"
	default n
    depends on TC_CHARGER
```

## kernel/configs/cm8_h973_defconfig
```kconfig
CONFIG_IR_LED_USE_VBAT_POWER=y
CONFIG_RC_CORE=y
CONFIG_LIRC=y
CONFIG_DISPLAYPORT_SUPPORT=y
CONFIG_TYPEC_DP_ALTMODE=y
CONFIG_CUSTOM_KERNEL_IMGSENSOR="imx890_mipi_raw s5kjn1sub_mipi_raw s5kjn5tele_mipi_raw s5kjn1wide_mipi_raw s5kjn5fake_mipi_raw"
CONFIG_CUSTOM_TRAN_CAM_MATERIAL_CODE="imx890_17201956 s5kjn1sub_17201907 s5kjn5tele_17201948 s5kjn1wide_17201912 s5kjn5fake_17201948"
CONFIG_MTK_PLATFORM="mt6897"
CONFIG_TRAN_PREISP=y
CONFIG_TRAN_SHUBOIS=y
CONFIG_REGULATOR_FIXED_VOLTAGE=y
CONFIG_CUSTOM_TRAN_PROJECT="tran_cm8"
CONFIG_MTK_FLASHLIGHT_PT=n
CONFIG_TRAN_ENABLE_RPMB=y

CONFIG_TRANSSION_DYNAMIC_BIND_CPU=y
CONFIG_TRANSSION_MCQ=y
CONFIG_TRANSSION_BLK_UAS=y
CONFIG_TRAN_DISABLE_RECORD_INFO=y
CONFIG_TRANSSION_BLK_PERF_OPT=y

CONFIG_TRAN_AI_KEY_SUPPORT=y

CONFIG_TRAN_TOSPANIC_DEBUG_SUPPORT=y
CONFIG_TRAN_SYSTEM_SERVER_LOAD=y
CONFIG_TRAN_HEALTH_TNE=y


CONFIG_TRAN_GET_BRIGHTNESS_LEVEL_SUPPORT=y
CONFIG_TRAN_CHARGER_POLL=y
CONFIG_TRAN_SAR_DEBUG=y
CONFIG_AW_ACCDET_PLUG_CAIL=y
CONFIG_AW_USB_PLUG_CAIL=y
CONFIG_MTK_TINYSYS_SCP_DEBUG_SUPPORT=y
CONFIG_SENSOR_GET_SCREEN_POWER_STATE=y
CONFIG_TRAN_GET_VREFRESH_SUPPORT=y

CONFIG_TRAN_HBM_THERMAL_CTL=y


CONFIG_TRANS_SCHED_SHARE=y

CONFIG_ZRAM_WRITEBACK=y
CONFIG_TRAN_MEMORY_FUSION2_2_SUPPORT=y

CONFIG_NET_SCH_INGRESS=y
CONFIG_NET_CLS_FW=y
CONFIG_NET_CLS_FLOW=y
CONFIG_NET_ACT_POLICE=y
CONFIG_NET_ACT_MIRRED=y
CONFIG_NET_ACT_IPT=y
CONFIG_NET_CLS_IND=y
CONFIG_IFB=y
CONFIG_SDCARD_FS=y
CONFIG_MTK_MD3_SUPPORT=0
CONFIG_MTK_C2K_LTE_MODE=0
CONFIG_MTK_VOW_MAX_PDK_NUMBER=1
CONFIG_MTK_VOW_BARGE_IN_SUPPORT=y
CONFIG_MTK_VOW_GVA_SUPPORT=y
CONFIG_MTK_WIFI_6G_SUPPORT=y

CONFIG_TRAN_ADSP_EE_TRACKING=y
```

## kernel/configs/d8300evb_h973a_defconfig
```kconfig
CONFIG_IR_LED_USE_VBAT_POWER=y
CONFIG_RC_CORE=y
CONFIG_LIRC=y
CONFIG_DISPLAYPORT_SUPPORT=y
CONFIG_TYPEC_DP_ALTMODE=y
CONFIG_CUSTOM_KERNEL_IMGSENSOR="imx890_mipi_raw s5kjn1sub_mipi_raw s5kjn5tele_mipi_raw s5kjn1wide_mipi_raw s5kjn5fake_mipi_raw"
CONFIG_CUSTOM_TRAN_CAM_MATERIAL_CODE="imx890_17201871 s5kjn1sub_17201907 s5kjn5tele_17201860 s5kjn1wide_17201862 s5kjn5fake__17201917"
CONFIG_MTK_PLATFORM="mt6897"
CONFIG_TRAN_PREISP=y
CONFIG_REGULATOR_FIXED_VOLTAGE=y
CONFIG_CUSTOM_TRAN_PROJECT="tran_d8300evb"

CONFIG_TRAN_GET_BRIGHTNESS_LEVEL_SUPPORT=y
CONFIG_TRANS_SCHED_SHARE=y
```

## kernel/configs/d9300evb_h890a_defconfig
```kconfig
CONFIG_IR_LED_USE_VBAT_POWER=y
CONFIG_RC_CORE=y
CONFIG_LIRC=y
CONFIG_DISPLAYPORT_SUPPORT=y
CONFIG_TYPEC_DP_ALTMODE=y
CONFIG_CUSTOM_KERNEL_IMGSENSOR="imx890_mipi_raw hi3231qsub1_mipi_raw s5kjn1tele_mipi_raw hi3231qsub2_mipi_raw hi5022qwide_mipi_raw"
CONFIG_CUSTOM_TRAN_CAM_MATERIAL_CODE="imx890_17201871 hi3231qsub1_17201878 s5kjn1tele_17201860 hi3231qsub2_17201879 hi5022qwide_17201862"
CONFIG_MTK_PLATFORM="mt6989"
CONFIG_REGULATOR_FIXED_VOLTAGE=y
CONFIG_CUSTOM_TRAN_PROJECT="tran_d9300evb"
CONFIG_SMARTPA_RESETGPIO_CONNECT_AW95016=y
CONFIG_TRAN_GET_BRIGHTNESS_LEVEL_SUPPORT=y
```

## kernel/configs/lj7_h782_defconfig
```kconfig
CONFIG_TRAN_ENABLE_RPMB=y
CONFIG_IR_LED_USE_VBAT_POWER=y
CONFIG_RC_CORE=y
CONFIG_LIRC=y
CONFIG_CUSTOM_KERNEL_IMGSENSOR="s5kjn1_mipi_raw gc13a0_mipi_raw"
CONFIG_CUSTOM_TRAN_CAM_MATERIAL_CODE="s5kjn1_17201906 gc13a0_17201959"
CONFIG_MTK_PLATFORM="mt6878"
CONFIG_REGULATOR_FIXED_VOLTAGE=y
CONFIG_CUSTOM_TRAN_PROJECT="tran_lj7"
CONFIG_MTK_FLASHLIGHT_PT=n
CONFIG_TRAN_GET_BRIGHTNESS_LEVEL_SUPPORT=y
CONFIG_MTK_TINYSYS_SCP_DEBUG_SUPPORT=y
CONFIG_TRANS_SCHED_SHARE=y

CONFIG_TRAN_TOSPANIC_DEBUG_SUPPORT=y
CONFIG_NFC=y
CONFIG_SEC_NFC_PRODUCT_N5=y
CONFIG_SEC_NFC_IF_I2C=y
CONFIG_TRAN_HBM_THERMAL_CTL=y
CONFIG_ZRAM_WRITEBACK=y
CONFIG_TRAN_MEMORY_FUSION2_2_SUPPORT=y

CONFIG_NET_SCH_INGRESS=y
CONFIG_NET_CLS_FW=y
CONFIG_NET_CLS_FLOW=y
CONFIG_NET_ACT_POLICE=y
CONFIG_NET_ACT_MIRRED=y
CONFIG_NET_ACT_IPT=y
CONFIG_NET_CLS_IND=y
CONFIG_IFB=y
CONFIG_SDCARD_FS=y
CONFIG_MTK_MD3_SUPPORT=0
CONFIG_MTK_C2K_LTE_MODE=0
CONFIG_TRAN_SAR_DEBUG=y
CONFIG_AW_USB_PLUG_CAIL=y
CONFIG_AW_ACCDET_PLUG_CAIL=y
```

## kernel/configs/lj8k_h781_defconfig
```kconfig
CONFIG_TRAN_ENABLE_RPMB=y
CONFIG_TRANSSION_DYNAMIC_BIND_CPU=y
CONFIG_TRANSSION_BLK_UAS=y
CONFIG_TRAN_DISABLE_RECORD_INFO=y
CONFIG_TRANSSION_BLK_PERF_OPT=y
CONFIG_IR_LED_USE_VBAT_POWER=y
CONFIG_RC_CORE=y
CONFIG_LIRC=y
CONFIG_TRAN_SAR_DEBUG=y
CONFIG_AW_USB_PLUG_CAIL=y
CONFIG_AW_ACCDET_PLUG_CAIL=y
CONFIG_CUSTOM_KERNEL_IMGSENSOR="imx682_mipi_raw gc13a0ff_mipi_raw"
CONFIG_CUSTOM_TRAN_CAM_MATERIAL_CODE="imx682_17201926 gc13a0_17201930"
CONFIG_MTK_PLATFORM="mt6878"
CONFIG_TRAN_SHUBOIS=y
CONFIG_REGULATOR_FIXED_VOLTAGE=y
CONFIG_CUSTOM_TRAN_PROJECT="tran_lj8k"
CONFIG_MTK_FLASHLIGHT_PT=n
CONFIG_TRAN_GET_BRIGHTNESS_LEVEL_SUPPORT=y
CONFIG_MTK_TINYSYS_SCP_DEBUG_SUPPORT=y
CONFIG_TRAN_CHARGER_POLL=y
CONFIG_TRANS_SCHED_SHARE=y

CONFIG_TRAN_TOSPANIC_DEBUG_SUPPORT=y
CONFIG_TRAN_HBM_THERMAL_CTL=y
CONFIG_ZRAM_WRITEBACK=y
CONFIG_TRAN_MEMORY_FUSION2_2_SUPPORT=y

CONFIG_NET_SCH_INGRESS=y
CONFIG_NET_CLS_FW=y
CONFIG_NET_CLS_FLOW=y
CONFIG_NET_ACT_POLICE=y
CONFIG_NET_ACT_MIRRED=y
CONFIG_NET_ACT_IPT=y
CONFIG_NET_CLS_IND=y
CONFIG_IFB=y
CONFIG_SDCARD_FS=y
CONFIG_MTK_MD3_SUPPORT=0
CONFIG_MTK_C2K_LTE_MODE=0

CONFIG_TRAN_ADSP_EE_TRACKING=y

CONFIG_TRAN_HEALTH_TNE=y
```

## kernel/configs/lj9_h972_defconfig
```kconfig
CONFIG_IR_LED_USE_VBAT_POWER=y
CONFIG_RC_CORE=y
CONFIG_LIRC=y
CONFIG_CUSTOM_KERNEL_IMGSENSOR="s5khm6sx_mipi_raw gc13a0_mipi_raw gc08a8wide_mipi_raw"
CONFIG_CUSTOM_TRAN_CAM_MATERIAL_CODE="s5khm6sx_17201842 gc13a0_17201930 gc08a8wide_17201942"
CONFIG_MTK_PLATFORM="mt6897"
CONFIG_REGULATOR_FIXED_VOLTAGE=y
CONFIG_CUSTOM_TRAN_PROJECT="tran_lj9"
CONFIG_TRAN_SHUBOIS=n
CONFIG_MTK_FLASHLIGHT_PT=n
CONFIG_TRAN_ENABLE_RPMB=y
CONFIG_TRAN_GET_BRIGHTNESS_LEVEL_SUPPORT=y
CONFIG_MTK_TINYSYS_SCP_DEBUG_SUPPORT=y
CONFIG_TRAN_TOSPANIC_DEBUG_SUPPORT=y
CONFIG_ZRAM_WRITEBACK=y
CONFIG_TRAN_MEMORY_FUSION2_2_SUPPORT=y
CONFIG_NET_SCH_INGRESS=y
CONFIG_NET_CLS_FW=y
CONFIG_NET_CLS_FLOW=y
CONFIG_NET_ACT_POLICE=y
CONFIG_NET_ACT_MIRRED=y
CONFIG_NET_ACT_IPT=y
CONFIG_NET_CLS_IND=y
CONFIG_IFB=y
CONFIG_SDCARD_FS=yCONFIG_MTK_MD3_SUPPORT=0
CONFIG_MTK_C2K_LTE_MODE=0
CONFIG_TRAN_SAR_DEBUG=y
CONFIG_AW_ACCDET_PLUG_CAIL=y
CONFIG_AW_USB_PLUG_CAIL=y
CONFIG_SENSOR_GET_LCM_INFO=y
CONFIG_TRAN_HBM_THERMAL_CTL=y
CONFIG_MTK_VOW_MAX_PDK_NUMBER=1
CONFIG_MTK_VOW_BARGE_IN_SUPPORT=y
CONFIG_MTK_VOW_GVA_SUPPORT=y
CONFIG_TRAN_ADSP_EE_TRACKING=y
CONFIG_MTK_WIFI_6G_SUPPORT=y
```
